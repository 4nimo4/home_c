// ============================================================================
//   ДОМАШНЯЯ МЕТЕОСТАНЦИЯ / ИМИТАТОР ИЛС ДЛЯ UNO R4 WIFI
//
//   Датчики:
//     - AHT20: температура и влажность воздуха (I2C)
//     - BMP280: давление и барометрическая высота (I2C)
//     - MPU6050: акселерометр + гироскоп, даёт "горизонт" и температуру (I2C)
//
//   Дисплей:
//     - TFT ST7735 1.8", 128x160, управление по SPI
//
//   Основные режимы экрана (displayMode):
//     0 – METEO: погода, давление, тренд, температура MPU, статусы датчиков
//     1 – HUD: искусственный горизонт (крен/тангаж), виртуальный курс,
//              "лестничная" высота, численные значения углов и высоты
//
//   Кнопка (D2, INPUT_PULLUP):
//     - короткое нажатие  (< 1.5 c) – переключение между METEO и HUD;
//     - длинное нажатие  (>= 1.5 c), только в HUD и при живом MPU –
//         ручной "сброс нуля":
//           * запоминаем текущее положение как ноль горизонта
//             (roll_zero_deg / pitch_zero_deg);
//           * обнуляем виртуальный курс (heading_deg = 0) относительно этого
//             горизонта;
//           * флаги horizonZeroSet / headingZeroSet = true.
//
//   Особенности логики:
//     - MPU6050 даёт крен/тангаж; ноль горизонта запоминается один раз при
//       первом успешном initMPU() и/или при ручном "сбросе нуля" кнопкой.
//     - Виртуальный курс считается по интегралу крена (heading_deg), ноль курса
//       так же запоминается один раз (initMPU или ручной сброс).
//     - Высота по BMP280: при старте усредняется несколько измерений, это место
//       принимается за "0 м" (altitudeOffset_m). Для HUD используется
//       сглаженная и "квантуемая" высота altStep_m.
//     - Любая серьёзная ошибка ENV (AHT/BMP) или MPU → общий сброс питания
//       всех датчиков (reinitAllSensors()), перекалибровка и "тихий" период
//       recovering, чтобы не зациклиться на ошибках.
// ============================================================================

#include <Arduino.h>
#include <Wire.h>        // I2C (MPU6050, AHT20, BMP280)
#include <SPI.h>         // SPI (TFT-дисплей)

#include <Adafruit_GFX.h>
#include <Adafruit_ST7735.h>
#include <Adafruit_AHTX0.h>
#include <Adafruit_BMP280.h>

#include <CBTimer.h>     // Таймер для мигания ERR / служебных задач

// ============================================================================
//  [CFG] ОБЩИЕ НАСТРОЙКИ И КОНСТАНТЫ
// ============================================================================

// --- TFT / текст ---
// Поворот экрана относительно физической ориентации модуля (0..3)
#define SET_ROTAC 2
// Размеры шрифтов для разных типов надписей
#define ZAGOLOVOK 2      // крупный шрифт для сообщений и статуса init
#define OSN_TEXT  1      // основной текст (METEO)
#define DATCHIK   1      // подписи датчиков

// Смещения по X для подписей и значений (METEO-экран)
#define SMESH_L1  2      // подписи MPU (если бы выводили текстом)
#define SMESH_L2  50     // значения MPU
#define SMESH_L3  2      // подписи ENV (Temp, Hydro, Dew, ...)
#define SMESH_L4  42     // значения ENV

// --- Дополнительные цвета RGB565 ---
#define ST77XX_NAVY      0x000F
#define ST77XX_DARKGREEN 0x03E0
#define ST77XX_DARKGREY  0x7BEF
#define ST77XX_LIGHTGREY 0xC618
#define ST77XX_MAROON    0x7800
#define ST77XX_PURPLE    0x780F
#define ST77XX_OLIVE     0x7BE0
#define ST77XX_BROWN     0x79E0
#define ST77XX_PINK      0xF81F

// --- Цвета сообщений (шапки, init, ошибки) ---
#define COL_TEXT1   ST77XX_WHITE
#define COL_FON1    ST77XX_PURPLE
#define COL_TEXT2   ST77XX_WHITE
#define COL_FON2    ST77XX_PURPLE
#define COL_TEXT3   ST77XX_RED
#define COL_FON3    ST77XX_PURPLE
#define COL_TEXT4   ST77XX_RED
#define COL_FON4    ST77XX_PURPLE
#define COL_TEXT5   ST77XX_WHITE
#define COL_FON5    ST77XX_PURPLE
#define COL_TEXT6   ST77XX_RED
#define COL_FON6    ST77XX_PURPLE
#define COL_TEXT7   ST77XX_WHITE
#define COL_FON7    ST77XX_PURPLE

// --- Цвета основных экранов ---
#define COL_TEXT8   ST77XX_GREEN   // текст каркаса HUD
#define COL_FON8    ST77XX_BLACK   // фон HUD
#define COL_TEXT9   ST77XX_YELLOW  // данные HUD

#define COL_TEXT10  ST77XX_GREEN   // текст METEO
#define COL_FON10   ST77XX_BLACK   // фон METEO
#define COL_TEXT11  ST77XX_YELLOW  // численные значения ENV
#define COL_TEXT12  ST77XX_WHITE   // заголовки/подписи

// --- TFT ST7735 1.8" 128x160: пины управления ---
#define TFT_CS   10
#define TFT_DC    9
#define TFT_RST   8

// --- Питание датчиков через транзисторы BC327 ---
//   AHT20 + BMP280 (3.3В) висят на одном PNP-транзисторе:
#define AHT_BMP_PWR_PIN   3   // D3 - транзистор питания AHT20/BMP280 (HIGH=выкл, LOW=вкл)
#define SV1_INDIC_PWR_PIN 4   // D4 - светодиод-индикатор питания AHT20/BMP280

//   MPU6050 (5В) – на отдельном PNP-транзисторе:
#define MPU_PWR_PIN       5   // D5 - транзистор питания 5V на MPU6050 (LOW=вкл, HIGH=выкл)
#define SV2_MPU_INDIC_PIN 6   // D6 - светодиод питания MPU6050 (HIGH=вкл, LOW=выкл)

// --- Кнопка и тайминги UI ---
const int buttonPin = 2;                 // D2, общая кнопка режима/сброса
const unsigned long DEBOUNCE_MS = 50;    // антидребезг по времени, мс

// Длинное нажатие для ручного "сброса нуля" горизонта/курса
const unsigned long LONG_PRESS_MS = 1500;   // 1.5 секунды удержания

// Внутреннее состояние кнопки
bool   buttonPressed      = false;       // факт, что сейчас кнопка нажата
unsigned long buttonPressStart = 0;      // время начала нажатия
bool   longPressHandled   = false;       // уже отработали длинное нажатие или нет

// --- Частоты обновления экранов ---
// METEO обновляем медленно, HUD – быстрее для плавной анимации
const unsigned long SCREEN_UPDATE_INTERVAL_METEO = 2000;  // 2 секунды
const unsigned long SCREEN_UPDATE_INTERVAL_HUD   = 200;   // 200 мс (~5 Гц)

// --- Опрос ENV-датчиков ---
const unsigned long SENSOR_POLL_INTERVAL = 500;           // METEO: каждые 500 мс
unsigned long lastSensorPoll = 0;                         // последний METEO-опрос

// HUD-режим: отдельный (редкий) опрос ENV, чтобы не грузить шину
const unsigned long HUD_SENSOR_POLL_INTERVAL = 2000;      // HUD: 1 раз в 2 секунды
unsigned long lastHudEnvPoll = 0;                         // последний HUD-опрос

// --- Автовосстановление AHT/BMP (через reinitAllSensors) ---
const unsigned long AHT_RETRY_INTERVAL = 5000;            // минимальный интервал повторной попытки
unsigned long lastAhtRetry = 0;

// --- Попытки восстановления MPU ---
const unsigned long MPU_RETRY_INTERVAL = 3000;            // базовый интервал повтора
unsigned long lastMpuRetry = 0;

// --- Периодический вывод в Serial (METEO-режим) ---
unsigned long serialPrintInterval = 60000;                // лог в Serial раз в 60 секунд

// --- Оценка "погоды" по давлению (примерные пороги) ---
const float P_LOW  = 710.0;                               // низкое давление (мм рт. ст.)
const float P_HIGH = 730.0;                               // высокое давление (мм рт. ст.)
const unsigned long TREND_INTERVAL = 10UL * 60UL * 1000UL; // период оценки тренда, 10 минут

// --- Фильтр MPU (экспоненциальное сглаживание акселя/гиро/температуры) ---
const float alpha = 0.1f;                                 // 0..1, чем меньше – тем "ленивее"

// --- Масштаб тангажа в HUD (пикселей на градус) ---
const float PITCH_PX_PER_DEG = 2.0f;

// --- Опорное давление для высоты (hPa) ---
// Для относительных изменений не критично, но для "красивой" абсолютной
// высоты можно подставлять актуальный QNH.
const float SEA_LEVEL_HPA = 1013.25f;

// ============================================================================
//   ГЛОБАЛЬНЫЕ ОБЪЕКТЫ
// ============================================================================
Adafruit_ST7735 tft(TFT_CS, TFT_DC, TFT_RST);  // TFT-дисплей
Adafruit_AHTX0   aht;                         // датчик AHT20
Adafruit_BMP280  bmp;                         // датчик BMP280
CBTimer          uiTimer;                     // таймер для миганий и служебных задач

// ============================================================================
//   ПЕРЕМЕННЫЕ СОСТОЯНИЯ
// ============================================================================

// --- MPU6050 / ориентация и курс ---
float roll_deg  = 0.0f;       // крен относительно "запомненного" горизонта, градусы
float pitch_deg = 0.0f;       // тангаж относительно "запомненного" горизонта, градусы
float heading_deg = 0.0f;     // виртуальный курс по интегралу крена, 0..360

// Высота (опорный ноль по баро для относительных изменений)
float altZeroRef    = 0.0f;   // высота в момент выбора нулевого уровня
bool  altZeroRefSet = false;  // флаг, что ноль высоты уже зафиксирован

// Дополнительный сглаженный крен исключительно для расчёта курса,
// чтобы heading_deg меньше дёргался от шума.
float roll_for_heading_deg = 0.0f;
const float HEADING_ROLL_ALPHA = 0.2f;  // коэффициент сглаживания крена для курса

// --- "виртуальный курс" по интегралу крена ---
float last_roll_for_heading = 0.0f;     // предыдущее значение крена для интегрирования
bool  headingInitDone = false;          // инициализирован ли модуль курса

// --- Оффсеты горизонта (запоминаемый ноль при первом старте или ручном сбросе) ---
float roll_zero_deg  = 0.0f;            // физический крен, принятый за "0"
float pitch_zero_deg = 0.0f;            // физический тангаж, принятый за "0"
bool  horizonZeroSet = false;           // ноль горизонта уже зафиксирован

// --- Флаг: ноль курса уже зафиксирован (по первому init или ручному сбросу) ---
bool  headingZeroSet = false;

// Последние нормированные значения MPU (для логов при ошибках)
float ax_last = 0, ay_last = 0, az_last = 0;
float gx_last = 0, gy_last = 0, gz_last = 0;
float temp_last = 0;

unsigned long mpuLastInitTime = 0;              // время последнего initMPU()
const unsigned long MPU_GRACE_MS = 1000;        // "льготный" период после init, мс

const uint8_t MPU_ADDR = 0x68;                  // адрес MPU6050 на I2C
bool mpu_ok = false;                            // флаг, что MPU сейчас в рабочем состоянии

// Контроль ошибок MPU
bool mpu_error = false;                         // последняя ошибка MPU
unsigned long mpuErrCount = 0;                  // накопленный счётчик ошибок MPU
unsigned long mpuNotFoundCount = 0;             // сколько раз не нашли устройство
uint8_t mpuReadErrorStreak = 0;                 // текущая серия ошибок чтения подряд
bool mpuHwWarnShown = false;                    // чтобы не дублировать HW-предупреждения

// Статистика ошибок MPU относительно движения (стояли / двигались)
unsigned long mpuErrWhileStill  = 0;
unsigned long mpuErrWhileMoving = 0;

// Оффсеты для калибровки MPU (аксель/гиро/температура)
float ax_offset = 0, ay_offset = 0, az_offset = 0;
float gx_offset = 0, gy_offset = 0, gz_offset = 0;
float temp_offset = 0;

// Сглаженные значения MPU, после экспоненциального фильтра alpha
float ax_f = 0, ay_f = 0, az_f = 0;
float gx_f = 0, gy_f = 0, gz_f = 0;
float temp_f = 0;

// --- AHT20 + BMP280 (ENV) ---
bool aht_ok = false;                    // текущее состояние AHT
bool bmp_ok = false;                    // текущее состояние BMP
bool poterya_svyazi = false;           // общая потеря связи по ENV-шине

// Текущие ENV-значения
float aht_tC = 0;                       // температура по AHT
float aht_hR = 0;                       // влажность по AHT
float p_mmHg = 0;                       // давление в мм рт. ст.
float altitude_m = 0;                   // "сырая" высота (относительно SEA_LEVEL_HPA - offset)
float altitudeOffset_m = 0;            // опорная высота (средняя при старте)
float altitude_m_f = 0;                // сглаженная высота

unsigned long lastBmpReadMs = 0;       // время последнего успешного чтения BMP

// --- Режим стабилизации высоты после старта ---
unsigned long startTime = 0;           // время включения
const unsigned long ALT_STAB_MS = 10000; // сколько ждать стабилизацию высоты (10 с)

// Счётчики отказов ENV
unsigned long ahtErrCount = 0;
unsigned long bmpErrCount = 0;

// --- Режим восстановления после общего сброса датчиков ---
bool recovering = false;               // сейчас в "тихом" восстановительном периоде
unsigned long recoverUntilMs = 0;      // до какого времени не трогаем датчики
const unsigned long RECOVER_MS = 2000; // 2 секунды "тишины" после reinitAllSensors

// --- Режимы экранов и кнопка ---
int displayMode = 0;                   // 0=METEO, 1=HUD
unsigned long lastScreenUpdate = 0;    // время последнего перерисовывания экрана

bool lastButtonState = HIGH;           // последнее считанное состояние кнопки
unsigned long lastButtonChange = 0;    // время последнего изменения кнопки

// --- Вывод в SERIAL ---
unsigned long lastSerialPrint = 0;     // когда последний раз печатали METEO-лог

// --- TREND давления ---
float p_trend_ref = 0;                 // опорное давление для тренда
unsigned long lastTrendTime = 0;       // время последней оценки тренда

// --- TREND давления ---
// Состояние тренда атмосферного давления за длительный интервал (TREND_INTERVAL):
//   - FALL   : давление заметно падает
//   - STEADY : давление примерно стабильно
//   - RISE   : давление заметно растёт
//   - TUNKNOWN : тренд ещё не определён (недостаточно данных или датчик не готов)
enum TrendState {
  T_STATE_FALL,     // падение давления (погода, как правило, портится)
  T_STATE_STEADY,   // давление стабильно, существенных изменений нет
  T_STATE_RISE,     // рост давления (как правило, улучшение погоды)
  T_STATE_TUNKNOWN  // тренд ещё не посчитан или данные недоступны
};

// Текущее оценённое состояние тренда давления.
// Обновляется в loop() раз в TREND_INTERVAL миллисекунд (см. [F18.4]).
TrendState pressureTrend = T_STATE_TUNKNOWN;

// --- CBTimer / мигание ---
volatile bool blinkErr = false;        // флаг для мигания / индикаторов

// --- Состояние по высоте (баро "лестница") ---
// Логика "лестницы" высоты в HUD:
//   - мы не показываем каждое дрожание баро, а пытаемся понять,
//     есть ли устойчивое движение вверх/вниз или высота стабилизировалась.
//   - по dAlt (изменению сглаженной высоты altitude_m_f) выбираем состояние:
// Эти состояния используются в pollEnvOnce() при расчёте altStep_m
// (см. блок [F13.1.2]).
enum AltState {
  ALT_IDLE,        // стоим, нет выраженного движения по высоте
  ALT_MOVING_UP,   // устойчивое движение вверх по бароданным
  ALT_MOVING_DOWN  // устойчивое движение вниз по бароданным
};

// Текущее состояние высоты для "лестницы" altStep_m.
AltState altState = ALT_IDLE;

// "дискретная" высота, которую показываем на HUD (лестница)
float altStep_m = 0.0f;

// последняя "зафиксированная" высота при остановке (можно использовать при необходимости)
float altLock_m = 0.0f;

// порог для определения направления изменения высоты по баро
const float ALT_DIR_THRESH = 0.02f;   // 2 см

// ============================================================================
//   ПРОТОТИПЫ
// ============================================================================
// --- Состояние давления (для METEO-экрана и логики тренда) ---
// P_STATE_LOW    : давление ниже порога P_LOW  -> "низкое"
// P_STATE_NORMAL : между P_LOW и P_HIGH        -> "нормальное"
// P_STATE_HIGH   : выше P_HIGH                 -> "высокое"
// P_STATE_UNKNOWN: датчик давления недоступен или значение невалидно
enum PressureState {
  P_STATE_LOW,
  P_STATE_NORMAL,
  P_STATE_HIGH,
  P_STATE_UNKNOWN
};

// --- Состояние "комфорта" по температуре и влажности (AHT20) ---
// C_STATE_DRY     : слишком сухо (низкая влажность)
// C_STATE_COMFORT : комфортный диапазон
// C_STATE_HUMID   : слишком влажно (и достаточно тепло)
// C_STATE_UNKNOWN : нет данных с AHT20
enum ComfortState {
  C_STATE_DRY,
  C_STATE_COMFORT,
  C_STATE_HUMID,
  C_STATE_UNKNOWN
};

// Возвращает "зону" давления по текущему p (мм рт. ст.)
// Использует глобальные пороги P_LOW / P_HIGH и флаг bmp_ok.
PressureState getPressureState(float p);

// Определяет состояние комфорта по tC (°C) и hR (% влажности)
// с учётом текущих порогов (смотреть реализацию getComfortState()).
ComfortState getComfortState(float tC, float hR);

// Вычисляет температуру точки росы (°C) по формуле Магнуса
// на основе текущей температуры (tC, °C) и относительной влажности (hR, %).
float calcDewPoint(float tC, float hR);

// --- Низкоуровневый доступ к MPU6050 через I2C ---
// Записать байт data в регистр reg MPU6050 по адресу MPU_ADDR.
void   mpuWrite(uint8_t reg, uint8_t data);

// Прочитать len байт из регистра reg MPU6050 в буфер buf.
// Возвращает фактически прочитанное количество байт (0 при ошибке I2C).
uint8_t mpuRead(uint8_t reg, uint8_t *buf, uint8_t len);

// Калибровка MPU6050 по акселю/гиро: усреднение samples измерений
// в статичном положении. Заполняет глобальные оффсеты ax_offset/...,
// возвращает true при успехе, false при полном провале чтений.
bool   calibrateMPU(unsigned int samples = 200);

// Полная инициализация MPU6050:
//   - проверка присутствия на I2C (WHO_AM_I);
//   - установка диапазонов;
//   - сброс оффсетов и вызов calibrateMPU();
//   - одно контрольное чтение;
//   - при первом успешном init фиксирует ноль горизонта и ноль курса.
// Возвращает true, если MPU успешно вышел в рабочее состояние.
bool   initMPU();

// --- Работа с TFT-дисплеем ---
// Показать одно строковое сообщение text по центру экрана,
// с заданным размером шрифта и цветами текста/фона.
void showMessageTFT(const char *text, uint8_t size,
                    uint16_t color_text, uint16_t color_fon);

// Очистить экран и подготовить фон/настройки для HUD.
// Сейчас просто заливает фон и отключает перенос текста.
void drawMPUFrame();

// Нарисовать статический каркас METEO-экрана:
// заголовок, подписи полей (Temp, Hydro, Dew, ...), подписи статусов датчиков.
void drawEnvFrame();

// Полная отрисовка HUD по текущим глобальным значениям:
//   - линия горизонта, дуга крена, самолётик;
//   - шкалы крена/тангажа;
//   - окно высоты;
//   - шкала виртуального курса;
//   - числовые значения крена/тангажа.
void drawHud();

// Обновить значения на METEO-экране (цифровая часть):
//   - Temperaturа, влажность, точка росы;
//   - давление, тренд давления;
//   - температура MPU;
//   - статусы датчиков (OK/ERR + счётчики ошибок).
void updateEnvValues();

// --- Логика переинициализации датчиков ---
// Перезапуск только MPU (сейчас реализован как вызов полного reinitAllSensors).
void reinitMPUOnly(const char* reason);

// Перезапуск только ENV (AHT/BMP) без MPU.
// Пока не используется, оставлен как задел на будущее.
void reinitEnvOnly(const char* reason);

// Полный сброс всех датчиков (ENV + MPU):
//   - выключить питание AHT/BMP и MPU;
//   - включить питание заново;
//   - повторно вызвать aht.begin(), bmp.begin(), initMPU();
//   - установить recovering = true на RECOVER_MS.
void reinitAllSensors(const char* reason);

// Ручной "сброс нуля" при длинном нажатии кнопки в HUD:
//   - текущие ax_f/ay_f/az_f -> вычислить roll/pitch;
//   - записать roll_zero_deg/pitch_zero_deg;
//   - обнулить heading_deg, привязать курс к этому горизонту;
//   - обновить флаги horizonZeroSet/headingZeroSet.
// Используется только если mpu_ok == true и displayMode == 1.
void manualZeroReset();

// Один опрос ENV-датчиков (AHT + BMP) + обработка высоты:
//   - чтение температуры/влажности с AHT;
//   - чтение давления/высоты с BMP;
//   - сглаживание altitude_m_f;
//   - логика "лестницы" высоты (altStep_m) и состояний AltState;
//   - при серьёзной ошибке ENV -> reinitAllSensors().
void pollEnvOnce();

// ============================================================================
//   [F01] uiTimerCallback – коллбэк таймера CBTimer (1 Гц)
//   --------------------------------------------------------------------------
//   Эта функция вызывается таймером uiTimer с фиксированной частотой (1 Гц).
//   Мы используем её для мигания индикаторов и других простых периодических
//   задач. Сейчас она просто инвертирует флаг blinkErr.
// ============================================================================
void uiTimerCallback() {
  // Инвертируем булевый флаг blinkErr:
  //   false -> true, true -> false.
  // На основе этого флага можно организовать мигание светодиодов
  // или периодическую индикацию ошибок.
  blinkErr = !blinkErr;
}

// ============================================================================
//   [F02] getPressureState – классификация давления по зонам
//   --------------------------------------------------------------------------
//   Функция принимает текущее давление p (в мм рт. ст.) и возвращает одно из
//   состояний PressureState:
//
//     P_STATE_LOW     – давление ниже порога P_LOW  (низкое);
//     P_STATE_NORMAL  – между P_LOW и P_HIGH        (нормальное);
//     P_STATE_HIGH    – выше порога P_HIGH         (высокое);
//     P_STATE_UNKNOWN – датчик давления недоступен (bmp_ok == false).
//
//   Пороговые значения P_LOW и P_HIGH задаются глобальными константами.
// ============================================================================
PressureState getPressureState(float p) {
  // Если датчик BMP280 сейчас не в рабочем состоянии,
  // считаем давление неизвестным.
  if (!bmp_ok) return P_STATE_UNKNOWN;

  // Если давление ниже нижнего порога P_LOW, считаем его «низким».
  if (p < P_LOW)  return P_STATE_LOW;

  // Если давление выше верхнего порога P_HIGH, считаем его «высоким».
  if (p > P_HIGH) return P_STATE_HIGH;

  // Во всех остальных случаях давление попадает в «нормальный» диапазон.
  return P_STATE_NORMAL;
}

// ============================================================================
//   [F03] getComfortState – оценка «комфорта» по температуре и влажности
//   --------------------------------------------------------------------------
//   Функция анализирует текущую температуру tC (°C) и относительную влажность
//   hR (%) с AHT20 и возвращает одно из состояний ComfortState:
//
//     C_STATE_DRY     – слишком сухо (низкая влажность);
//     C_STATE_COMFORT – комфортный диапазон;
//     C_STATE_HUMID   – слишком влажно (и достаточно тепло);
//     C_STATE_UNKNOWN – данные недоступны (датчик AHT20 не в строю).
//
//   Внутри используются простые пороги по влажности и температуре.
// ============================================================================
ComfortState getComfortState(float tC, float hR) {
  // Если датчик AHT20 сейчас не в рабочем состоянии,
  // мы не можем оценить комфорт – возвращаем C_STATE_UNKNOWN.
  if (!aht_ok) return C_STATE_UNKNOWN;

  // Если относительная влажность ниже 35%, считаем воздух слишком сухим.
  if (hR < 35.0) return C_STATE_DRY;

  // Если влажность выше 65% и при этом достаточно тепло (tC > 24°C),
  // считаем условия чрезмерно влажными («спёртый» воздух).
  if (hR > 65.0 && tC > 24.0) return C_STATE_HUMID;

  // Во всех остальных случаях считаем условия примерно комфортными.
  return C_STATE_COMFORT;
}



// ============================================================================
//   [F04] calcDewPoint – расчёт точки росы по температуре и влажности
//   --------------------------------------------------------------------------
//   Функция вычисляет температуру точки росы (dp, °C) по текущей
//   температуре воздуха tC (°C) и относительной влажности hR (%).
//
//   Используется приближённая формула Магнуса, дающая хорошую точность
//   в «погодном» диапазоне температур:
//     gamma = a * T / (b + T) + ln(RH/100)
//     dp    = b * gamma / (a - gamma)
//   где a и b – эмпирические коэффициенты (здесь 17.62 и 243.12).
// ============================================================================
float calcDewPoint(float tC, float hR) {
  // Коэффициенты a и b для формулы Магнуса (вариант для воды при обычных условиях).
  double a = 17.62;
  double b = 243.12;

  // Промежуточная величина gamma – «логарифмическая» часть формулы,
  // зависящая от температуры и относительной влажности.
  double gamma = (a * tC / (b + tC)) + log(hR / 100.0);

  // Собственно расчёт температуры точки росы по формуле.
  double dp = (b * gamma) / (a - gamma);

  // Возвращаем результат как float (точности для метеозадачи достаточно).
  return (float)dp;
}

// ============================================================================
//   [F05] mpuWrite – запись байта в регистр MPU6050
//   --------------------------------------------------------------------------
//   Функция записывает один байт data в регистр reg устройства MPU6050
//   по адресу MPU_ADDR через шину I2C. Ошибки здесь явно не обрабатываются,
//   предполагается, что конфигурационные записи выполняются редко и
//   контролируются косвенно через последующие чтения.
// ============================================================================
void mpuWrite(uint8_t reg, uint8_t data) {
  // Начинаем передачу к устройству с адресом MPU_ADDR.
  Wire.beginTransmission(MPU_ADDR);

  // Сначала отправляем номер регистра, в который будем писать.
  Wire.write(reg);

  // Затем отправляем само значение, которое хотим записать в этот регистр.
  Wire.write(data);

  // Завершаем передачу. Если на этом этапе произойдёт ошибка,
  // её код можно было бы прочитать, но здесь мы его не используем.
  Wire.endTransmission();
}

// ============================================================================
//   [F06] mpuRead – чтение регистра MPU6050 с учётом ошибок I2C
//   --------------------------------------------------------------------------
//   Функция читает len байт из регистра reg по адресу MPU_ADDR в буфер buf.
//   Возвращает фактически прочитанное количество байт (0 при ошибке start/адреса).
//
//   Особенности:
//     - логирует ошибки endTransmission (проблемы с шиной I2C);
//     - при ошибках увеличивает mpuReadErrorStreak и mpuErrCount;
//     - логирует «укороченное» чтение (когда пришло меньше, чем запрошено).
// ============================================================================
uint8_t mpuRead(uint8_t reg, uint8_t *buf, uint8_t len) {
  // Начинаем передачу к устройству MPU по адресу MPU_ADDR.
  Wire.beginTransmission(MPU_ADDR);

  // Записываем в шину номер регистра, с которого хотим читать.
  Wire.write(reg);

  // Завершаем передачу, но НЕ посылаем стоп (false) – оставляем шину «открытой»
  // для последующего requestFrom (restart condition).
  uint8_t err = Wire.endTransmission(false);

  // Если err != 0, значит, на этапе адресации/записи регистра произошла ошибка I2C.
  if (err != 0) {
    // Фиксируем текущее время для лога.
    unsigned long now = millis();

    // Логируем код ошибки endTransmission.
    Serial.print("MPU I2C endTransmission error=");
    Serial.print(err);
    Serial.print(" at ms=");
    Serial.println(now);

    // Считаем это ошибкой чтения:
    // увеличиваем streak подряд идущих проблемных чтений.
    mpuReadErrorStreak++;

    // И общий накопительный счётчик ошибок MPU.
    mpuErrCount++;

    // Возвращаем 0, чтобы вызывающий код понял, что чтение не удалось.
    return 0;
  }

  // Если адресация прошла успешно, запрашиваем len байт от устройства.
  uint8_t readCount = Wire.requestFrom((int)MPU_ADDR, (int)len);

  // Если пришло меньше байт, чем запрашивали, логируем это как «короткое чтение».
  if (readCount != len) {
    unsigned long now = millis();
    Serial.print("MPU I2C short requestFrom: got ");
    Serial.print(readCount);
    Serial.print(" of ");
    Serial.print(len);
    Serial.print(" bytes at ms=");
    Serial.println(now);
  }

  // Считываем фактически доступные байты из I2C-буфера в пользовательский буфер buf.
  for (uint8_t i = 0; i < readCount && i < len; i++) {
    buf[i] = Wire.read();
  }

  // Возвращаем количество реально прочитанных байт.
  return readCount;
}

// ============================================================================
//   [F07] calibrateMPU – мягкая калибровка MPU6050 с проверкой чтений
//   --------------------------------------------------------------------------
//   В этой функции мы:
//     1) несколько раз подряд читаем полный блок данных MPU (аксель+гиро+температура);
//     2) отбрасываем невалидные чтения (короткие по длине);
//     3) усредняем «сырые» значения по каждой оси;
//     4) записываем усреднённые значения в ax_offset/ay_offset/az_offset и др.;
//     5) для акселя по Z вычитаем 1g (16384 LSB) — ожидаем, что в покое az ≈ +1g;
//     6) возвращаем true при наличии хотя бы одного валидного чтения, иначе false.
//
//   Предполагается, что на время калибровки модуль MPU6050 неподвижен.
// ============================================================================
bool calibrateMPU(unsigned int samples) {
  // Пишем в лог, что начинаем калибровку, и просим не трогать датчик.
  Serial.println("Calibrating MPU... Keep sensor still.");

  // Накопители суммы сырых значений акселерометра по всем осям.
  long ax_sum = 0, ay_sum = 0, az_sum = 0;

  // Накопители суммы сырых значений гироскопа по всем осям.
  long gx_sum = 0, gy_sum = 0, gz_sum = 0;

  // Накопитель суммы сырой температуры (пока не используем).
  long temp_sum = 0;

  // Счётчик «хороших» (полноценных) выборок, по которым делаем усреднение.
  unsigned int goodSamples = 0;

  // Цикл по количеству выборок, заданному параметром samples.
  for (unsigned int i = 0; i < samples; i++) {
    // Буфер для чтения 14 байт: аксель (6), температура (2), гироскоп (6).
    uint8_t data[14];

    // Читаем из MPU блок данных начиная с регистра 0x3B.
    uint8_t rc = mpuRead(0x3B, data, 14);

    // Если прочитано меньше 14 байт, считаем это невалидным чтением.
    if (rc < 14) {
      // Небольшая пауза перед следующей попыткой и переходим к следующей итерации.
      delay(5);
      continue;
    }

    // Распаковываем сырые значения акселя по осям X, Y, Z.
    int16_t ax_raw  = (int16_t)(data[0] << 8 | data[1]);
    int16_t ay_raw  = (int16_t)(data[2] << 8 | data[3]);
    int16_t az_raw  = (int16_t)(data[4] << 8 | data[5]);

    // Распаковываем сырое значение температуры.
    int16_t tempRaw = (int16_t)(data[6] << 8 | data[7]);

    // Распаковываем сырые значения гироскопа по осям X, Y, Z.
    int16_t gx_raw  = (int16_t)(data[8] << 8 | data[9]);
    int16_t gy_raw  = (int16_t)(data[10] << 8 | data[11]);
    int16_t gz_raw  = (int16_t)(data[12] << 8 | data[13]);

    // Добавляем текущие сырые значения в сумматоры акселерометра.
    ax_sum   += ax_raw;
    ay_sum   += ay_raw;
    az_sum   += az_raw;

    // Добавляем текущие сырые значения в сумматоры гироскопа.
    gx_sum   += gx_raw;
    gy_sum   += gy_raw;
    gz_sum   += gz_raw;

    // Добавляем сырую температуру в сумматор (можно использовать при желании).
    temp_sum += tempRaw;

    // Увеличиваем счётчик валидных выборок.
    goodSamples++;

    // Небольшая пауза между измерениями, чтобы не опрашивать MPU слишком часто.
    delay(5);
  }

  // Если после цикла не набралось ни одной валидной выборки,
  // считаем, что калибровка провалилась.
  if (goodSamples == 0) {
    Serial.println("MPU calibration FAILED: no valid samples");
    return false;
  }

  // Вычисляем средние значения по акселю.
  float ax_avg = (float)ax_sum / goodSamples;
  float ay_avg = (float)ay_sum / goodSamples;
  float az_avg = (float)az_sum / goodSamples;

  // Вычисляем средние значения по гироскопу.
  float gx_avg = (float)gx_sum / goodSamples;
  float gy_avg = (float)gy_sum / goodSamples;
  float gz_avg = (float)gz_sum / goodSamples;

  // temp_sum сейчас не используем явно (оставляем заглушку).
  (void)temp_sum;

  // --------------------------------------------------------------------------
  // Формируем программные оффсеты:
  //   - для акселя X и Y берём среднее как «нулевое» смещение;
  //   - для акселя Z дополнительно вычитаем 1g (16384 LSB),
  //     так как в покое ожидаем az ≈ +1g вверх;
  //   - для гироскопа X/Y/Z берём средние как нулевые смещения;
  //   - температурный оффсет выставляем в 0 (можно донастроить при необходимости).
  // --------------------------------------------------------------------------

  // Оффсеты акселя по X и Y.
  ax_offset   = ax_avg;
  ay_offset   = ay_avg;

  // Оффсет акселя по Z с учётом гравитации (16384 LSB ≈ 1g).
  az_offset   = az_avg - 16384;

  // Оффсеты гироскопа по всем осям.
  gx_offset   = gx_avg;
  gy_offset   = gy_avg;
  gz_offset   = gz_avg;

  // Температурный оффсет пока не используем — оставляем 0.
  temp_offset = 0.0f;

  // Пишем в лог, что калибровка завершена, и выводим,
  // сколько валидных выборок мы смогли собрать.
  Serial.print("MPU calibration done. goodSamples=");
  Serial.println(goodSamples);

  // Возвращаем true — калибровка прошла успешно.
  return true;
}

// ============================================================================
//   [F08] initMPU – инициализация и калибровка MPU6050
//   --------------------------------------------------------------------------
//   В этой функции мы:
//     1) проверяем наличие MPU6050 на шине I2C (по адресу MPU_ADDR);
//     2) читаем регистр WHO_AM_I для верификации устройства;
//     3) настраиваем режимы работы (диапазоны акселя/гиро, вывод из sleep);
//     4) выполняем мягкую калибровку акселерометра и гироскопа (calibrateMPU);
//     5) делаем контрольное чтение и первичный расчёт углов;
//     6) один раз фиксируем ноль горизонта (roll_zero_deg/pitch_zero_deg);
//     7) один раз фиксируем ноль виртуального курса (heading_deg = 0).
//
//   При успехе выставляем mpu_ok = true и возвращаем true.
//   При любой серьёзной ошибке возвращаем false и логируем её в Serial.
// ============================================================================
bool initMPU() {
  // --------------------------------------------------------------------------
  // [F08.1] Проверяем наличие устройства на шине I2C
  // --------------------------------------------------------------------------

  // Начинаем передачу к устройству с адресом MPU_ADDR.
  Wire.beginTransmission(MPU_ADDR);

  // Завершаем передачу и читаем статус.
  // err == 0 означает, что устройство откликнулось на адрес.
  uint8_t err = Wire.endTransmission();

  // Если была ошибка, значит, MPU6050 на шине не отвечает.
  if (err != 0) {
    // Помечаем, что MPU сейчас не в рабочем состоянии.
    mpu_ok = false;

    // Увеличиваем счётчик «сколько раз не нашли устройство».
    mpuNotFoundCount++;

    // Пишем подробный лог об отсутствии MPU на шине.
    Serial.print("MPU not found at 0x68, I2C err=");
    Serial.print(err);
    Serial.print("  mpuNotFoundCount=");
    Serial.println(mpuNotFoundCount);

    // Если ранее ещё не выводили аппаратное предупреждение,
    // делаем это один раз.
    if (!mpuHwWarnShown) {
      mpuHwWarnShown = true;
      Serial.println("MPU_HW_WARN: device not responding on I2C. Check VCC/GND/SDA/SCL and power transistor.");
    }

    // Возвращаем false — инициализация не удалась.
    return false;
  }

  // --------------------------------------------------------------------------
  // [F08.2] Чтение WHO_AM_I для проверки «подлинности» MPU
  // --------------------------------------------------------------------------

  // Переменная для хранения значения регистра WHO_AM_I.
  uint8_t whoami = 0;

  // Пытаемся прочитать 1 байт из регистра 0x75 (WHO_AM_I).
  uint8_t rcWho = mpuRead(0x75, &whoami, 1);

  // Если не удалось прочитать хотя бы один байт – ошибка шины/I2C.
  if (rcWho < 1) {
    // Отмечаем, что MPU не в рабочем состоянии.
    mpu_ok = false;

    // Логируем проблему чтения WHO_AM_I.
    Serial.println("MPU WHO_AM_I read failed");

    // Выводим расширенное аппаратное предупреждение один раз.
    if (!mpuHwWarnShown) {
      mpuHwWarnShown = true;
      Serial.println("MPU_HW_WARN: WHO_AM_I read failed. Check wiring, pull-ups, and MPU power (BC327).");
    }

    // Возвращаем false — инициализация прервана.
    return false;
  }

  // Пишем в лог считанное значение WHO_AM_I в шестнадцатеричном виде.
  Serial.print("MPU WHO_AM_I = 0x");
  Serial.println(whoami, HEX);

  // Ожидаемые значения WHO_AM_I для разных ревизий/совместимых чипов – 0x68 или 0x70.
  // Если значение нестандартное, фиксируем это в логе, но не останавливаем init.
  if (whoami != 0x68 && whoami != 0x70) {
    Serial.println("MPU WHO_AM_I unexpected, но продолжаем init");
  }

  // --------------------------------------------------------------------------
  // [F08.3] Настройка режимов: вывод из sleep, диапазоны акселя/гиро
  // --------------------------------------------------------------------------

  // Записываем 0x00 в регистр 0x6B (PWR_MGMT_1), тем самым «будим» MPU6050
  // из режима сна. После этого даём небольшую задержку.
  mpuWrite(0x6B, 0x00);
  delay(100);

  // Регистр 0x1C (ACCEL_CONFIG): настраиваем диапазон акселерометра.
  // 0x00 соответствует ±2g – максимальная чувствительность.
  mpuWrite(0x1C, 0x00);

  // Регистр 0x1B (GYRO_CONFIG): настраиваем диапазон гироскопа.
  // 0x00 соответствует ±250 dps – максимальная точность по малым углам.
  mpuWrite(0x1B, 0x00);
  delay(50);

  // --------------------------------------------------------------------------
  // [F08.3.1] Сброс ранее накопленных оффсетов
  // --------------------------------------------------------------------------

  // Обнуляем программные оффсеты акселерометра.
  ax_offset = ay_offset = az_offset = 0;

  // Обнуляем программные оффсеты гироскопа.
  gx_offset = gy_offset = gz_offset = 0;

  // Сбрасываем температурный оффсет.
  temp_offset = 0.0f;

  // --------------------------------------------------------------------------
  // [F08.4] Калибровка акселя/гиро в покое
  // --------------------------------------------------------------------------

  // Запускаем процедуру калибровки с заданным числом выборок (80).
  // Внутри calibrateMPU() мы усредняем серию измерений в статичном состоянии,
  // определяем смещения и записываем их в ax_offset/gx_offset/... .
  if (!calibrateMPU(80)) {
    // Если калибровка провалилась (не удалось набрать валидные выборки) —
    // считаем, что initMPU не удался.
    mpu_ok = false;
    Serial.println("initMPU: calibration failed");
    return false;
  }

  // --------------------------------------------------------------------------
  // [F08.5] Контрольное чтение блока данных после калибровки
  // --------------------------------------------------------------------------

  // Буфер для чтения 14 байт: аксель (6), температура (2), гироскоп (6).
  uint8_t data[14];

  // Пробуем один раз прочитать полный блок данных начиная с регистра 0x3B.
  uint8_t rc = mpuRead(0x3B, data, 14);

  // Если считали меньше 14 байт – это серьёзная ошибка.
  if (rc < 14) {
    mpu_ok = false;
    Serial.println("MPU initial read failed");
    return false;
  }

  // Распаковываем «сырые» значения акселя по трём осям.
  int16_t ax_raw  = (int16_t)(data[0] << 8 | data[1]);
  int16_t ay_raw  = (int16_t)(data[2] << 8 | data[3]);
  int16_t az_raw  = (int16_t)(data[4] << 8 | data[5]);

  // Распаковываем сырое значение температуры.
  int16_t tempRaw = (int16_t)(data[6] << 8 | data[7]);

  // Распаковываем «сырые» значения гироскопа по трём осям.
  int16_t gx_raw  = (int16_t)(data[8] << 8 | data[9]);
  int16_t gy_raw  = (int16_t)(data[10] << 8 | data[11]);
  int16_t gz_raw  = (int16_t)(data[12] << 8 | data[13]);

  // Применяем рассчитанные оффсеты и делители чувствительности:
  //   - для акселя: 16384 LSB/g при диапазоне ±2g;
  //   - для гироскопа: 131 LSB/(deg/s) при диапазоне ±250 dps.
  float ax = (ax_raw - ax_offset) / 16384.0f;
  float ay = (ay_raw - ay_offset) / 16384.0f;
  float az = (az_raw - az_offset) / 16384.0f;

  float gx = (gx_raw - gx_offset) / 131.0f;
  float gy = (gy_raw - gy_offset) / 131.0f;
  float gz = (gz_raw - gz_offset) / 131.0f;

  // Пересчитываем сырую температуру в градусы Цельсия по формуле из даташита.
  float tempC = (tempRaw / 340.0f) + 36.53f + temp_offset;

  // Инициализируем сглаженные значения акселя, гироскопа и температуры
  // текущими измерениями (стартовое состояние фильтра).
  ax_f = ax;  ay_f = ay;  az_f = az;
  gx_f = gx;  gy_f = gy;  gz_f = gz;
  temp_f = tempC;

  // Сохраняем эти же значения как «последние» для логов и диагностики
  // (используются при выводе состояния MPU в момент ошибок).
  ax_last   = ax;
  ay_last   = ay;
  az_last   = az;
  gx_last   = gx;
  gy_last   = gy;
  gz_last   = gz;
  temp_last = tempC;

  // --------------------------------------------------------------------------
  // [F08.6] Расчёт исходных roll/pitch и фиксация нуля горизонта
  // --------------------------------------------------------------------------

  // Вычисляем крен из акселерометра:
  // roll = atan2(ay, az).
  float roll_rad_init  = atan2(ay_f, az_f);

  // Вычисляем тангаж:
  // pitch = atan2(-ax, sqrt(ay^2 + az^2)).
  float pitch_rad_init = atan2(-ax_f, sqrt(ay_f * ay_f + az_f * az_f));

  // Переводим углы из радиан в градусы.
  float roll_raw_deg_init  = roll_rad_init  * 180.0f / PI;
  float pitch_raw_deg_init = pitch_rad_init * 180.0f / PI;

  // Если ноль горизонта ещё не был зафиксирован ранее, делаем это сейчас.
  if (!horizonZeroSet) {
    // Сохраняем текущее физическое положение как «нулевой» горизонт.
    roll_zero_deg  = roll_raw_deg_init;
    pitch_zero_deg = pitch_raw_deg_init;

    // Отмечаем, что ноль горизонта установлен.
    horizonZeroSet = true;

    // Логируем новые опорные значения углов.
    Serial.print("HORIZON zero captured: roll_zero=");
    Serial.print(roll_zero_deg, 1);
    Serial.print(" pitch_zero=");
    Serial.println(pitch_zero_deg, 1);
  }

  // Выставляем текущие roll_deg/pitch_deg с учётом сохранённого нуля горизонта.
  if (horizonZeroSet) {
    // Если ноль зафиксирован – считаем отклонение от него.
    roll_deg  = roll_raw_deg_init  - roll_zero_deg;
    pitch_deg = pitch_raw_deg_init - pitch_zero_deg;
  } else {
    // Теоретический случай (на практике не попадаем сюда) –
    // если ноль ещё не задан, берём «сырые» углы из акселя.
    roll_deg  = roll_raw_deg_init;
    pitch_deg = pitch_raw_deg_init;
  }

  // Указываем, что MPU успешно инициализирован и пока без ошибок.
  mpu_ok    = true;
  mpu_error = false;

  // Пишем в лог сообщение об успешной инициализации/калибровке.
  Serial.println("MPU initialized & calibrated.");

  // Запоминаем время последней успешной инициализации MPU.
  mpuLastInitTime = millis();

  // Сбрасываем флаг аппаратных предупреждений – текущее состояние нормальное.
  mpuHwWarnShown  = false;

  // --------------------------------------------------------------------------
  // [F08.7] Фиксация нуля виртуального курса (heading_deg)
  // --------------------------------------------------------------------------

  // Ноль курса фиксируем только один раз за «жизнь» устройства:
  // либо при самом первом успешном initMPU, либо при ручном сбросе нуля.
  if (!headingZeroSet) {
    // Устанавливаем текущий курс в 0°.
    heading_deg           = 0.0f;

    // Запоминаем текущий крен как опорное значение для интегратора курса.
    last_roll_for_heading = roll_deg;

    // Помечаем, что интегратор курса готов к работе.
    headingInitDone       = true;

    // Отмечаем, что ноль курса теперь зафиксирован.
    headingZeroSet        = true;

    // Логируем факт захвата нуля курса.
    Serial.print("HEADING zero captured at roll=");
    Serial.println(roll_deg, 1);
  } else {
    // Если ноль курса уже был установлен ранее,
    // просто разрешаем интегратору продолжить работу после нового init.
    headingInitDone = true;

    // heading_deg и last_roll_for_heading не трогаем,
    // чтобы курс продолжал считаться от исходного нуля.
  }

  // Возвращаем true – инициализация MPU прошла успешно.
  return true;
}

// ============================================================================
//   [F09] showMessageTFT – вывод одного строкового сообщения по центру экрана
//   --------------------------------------------------------------------------
//   Функция показывает переданное текстовое сообщение text по центру дисплея,
//   заливая весь экран указанным цветом фона и используя заданный размер
//   шрифта и цвет текста. Удобно для коротких статусов INIT / ERR / OK.
// ============================================================================
void showMessageTFT(const char *text, uint8_t size,
                    uint16_t color_text, uint16_t color_fon) {
  // Полностью заливаем экран цветом фона сообщения.
  tft.fillScreen(color_fon);

  // Отключаем автоматический перенос строк, чтобы текст печатался
  // строго с той позиции, которую мы зададим курсором.
  tft.setTextWrap(false);

  // Настраиваем цвет текста и цвет подложки под текст.
  tft.setTextColor(color_text, color_fon);

  // Устанавливаем размер шрифта (масштаб) согласно параметру size.
  tft.setTextSize(size);

  // Локальные переменные для расчёта габаритов текста.
  int16_t x1, y1;
  uint16_t w, h;

  // Вычисляем реальные границы прямоугольника, в который впишется text:
  //   (x1, y1) – смещение относительно заданной точки,
  //   (w, h)   – ширина и высота текста в пикселях.
  tft.getTextBounds(text, 0, 0, &x1, &y1, &w, &h);

  // Рассчитываем X так, чтобы текст оказался по центру экрана по горизонтали.
  int16_t x = (tft.width()  - w) / 2;

  // Рассчитываем Y так, чтобы текст оказался по центру экрана по вертикали.
  int16_t y = (tft.height() - h) / 2;

  // Устанавливаем курсор в вычисленную центральную позицию.
  tft.setCursor(x, y);

  // Печатаем переданную строку text.
  tft.print(text);
}

// ============================================================================
//   [F10] drawMPUFrame – подготовка фона для HUD-экрана
//   --------------------------------------------------------------------------
//   В этой функции мы готовим «пустой» фон под HUD:
//     - очищаем экран цветом фона;
//     - отключаем автоматический перенос строк.
//   Статическая геометрия HUD (горизонт, шкалы и т.п.) рисуется отдельно
//   в drawHud() и обновляется по мере необходимости.
// ============================================================================
void drawMPUFrame() {
  // Полностью заливаем экран цветом COL_FON1.
  // Это базовый фон для HUD-режима (например, фиолетовый или чёрный,
  // в зависимости от выбранной схемы).
  tft.fillScreen(COL_FON1);

  // Отключаем автоматический перенос текста по краю экрана.
  // Для HUD мы всегда сами задаём координаты текста, поэтому перенос
  // нам не нужен и может только мешать.
  tft.setTextWrap(false);
}

// ============================================================================
//   [F11] drawEnvFrame – статический каркас METEO-экрана
//   --------------------------------------------------------------------------
//   В этой функции мы один раз рисуем «шаблон» погодного экрана:
//     - очищаем фон;
//     - выводим заголовок вверху;
//     - расставляем подписи строк (Temp, Hydro, Dew, Psc, Trend, T_MPU);
//     - выводим подписи строк статусов датчиков (AHT20, BMP280, MPU).
//
//   Численные значения (температуры, давление, статусы OK/ERR и т.п.)
//   обновляются отдельно в функции updateEnvValues() и не трогают каркас.
// ============================================================================
void drawEnvFrame() {
  // Заливаем весь экран цветом фона METEO-экрана.
  tft.fillScreen(COL_FON1);

  // Отключаем автоматический перенос строк,
  // чтобы текст печатался ровно там, где мы укажем курсор.
  tft.setTextWrap(false);

  // Настраиваем цвет шрифта для заголовка и подписей:
  //   текст = COL_TEXT12, фон = COL_FON1.
  tft.setTextColor(COL_TEXT12, COL_FON1);

  // Выбираем размер шрифта 1 для заголовка (компактный, но читаемый).
  tft.setTextSize(1);

  // Текст заголовка METEO-экрана.
  const char *title = "WEATHER STATION";

  // Переменные под расчёт габаритов текста заголовка.
  int16_t x1, y1;
  uint16_t w, h;

  // Получаем реальные размеры строки title (w,h) и смещение (x1,y1)
  // при рисовании от точки (0,0). Это нужно, чтобы центрировать заголовок.
  tft.getTextBounds(title, 0, 0, &x1, &y1, &w, &h);

  // Вычисляем X так, чтобы текст оказался по центру экрана,
  // и дополнительно чуть сдвигаем влево на 10 пикселей «по вкусу».
  int16_t x = (tft.width()  - w) / 2 - 10;

  // Y‑координата заголовка — небольшой отступ от верхнего края.
  int16_t y = 4;

  // Ставим курсор в рассчитанную позицию.
  tft.setCursor(x, y);

  // Печатаем строку заголовка.
  tft.print(title);

  // Меняем цвет шрифта для основного текста METEO (подписи слева).
  tft.setTextColor(COL_TEXT10, COL_FON1);

  // Размер шрифта – основной, заданный константой OSN_TEXT.
  tft.setTextSize(OSN_TEXT);

  // Далее мы расставляем слева подписи полей ENV-части.
  // Координаты по X берём из SMESH_L3, по Y – «лесенкой» через 15 пикселей.

  // Подпись строки для температуры воздуха.
  tft.setCursor(SMESH_L3, 20);
  tft.print("Temp:");

  // Подпись строки для влажности воздуха.
  tft.setCursor(SMESH_L3, 35);
  tft.print("Hydro:");

  // Подпись строки для точки росы.
  tft.setCursor(SMESH_L3, 50);
  tft.print("Dew:");

  // Подпись строки для давления (в мм рт. ст.).
  tft.setCursor(SMESH_L3, 65);
  tft.print("Psc:");

  // Подпись строки для тренда давления.
  tft.setCursor(SMESH_L3, 80);
  tft.print("Trend:");

  // Подпись строки для температуры MPU6050 (как отдельного датчика).
  tft.setCursor(SMESH_L3, 95);
  tft.print("T_MPU:");

  // Ниже выводим подписи для строк статусов датчиков:
  //   AHT20, BMP280 и MPU. Их численное состояние (OK/ERR и счётчики)
  //   будет дорисовано правее в updateEnvValues().

  // Строка статуса для AHT20.
  tft.setCursor(SMESH_L3, 120);
  tft.print("AHT20:");

  // Строка статуса для BMP280.
  tft.setCursor(SMESH_L3, 132);
  tft.print("BMP280:");

  // Строка статуса для MPU6050.
  tft.setCursor(SMESH_L3, 144);
  tft.print("MPU:");
}

// ============================================================================
//   [F12] drawHud – основной HUD по MPU6050
//   --------------------------------------------------------------------------
//   Рисует полный «искусственный горизонт» для HUD-режима, используя:
//
//     - roll_deg        – текущий крен (относительно запомненного горизонта);
//     - pitch_deg       – текущий тангаж;
//     - heading_deg     – виртуальный курс (по интегралу крена);
//     - altStep_m       – «лестничную» баро-высоту для окна Alt;
//     - глобальные размеры и цвета TFT-дисплея.
//
//   Структура отрисовки:
//
//     [F12.1] Базовая горизонтальная линия по тангажу (без наклона по крену)
//     [F12.2] Дуга крена -90..+90° с рисками и крайними стрелками
//     [F12.3] Вторая линия горизонта, уже повёрнутая по текущему крену
//     [F12.4] Центральный «самолётик» (крылья + киль), вращающийся по крену
//     [F12.5] Правая вертикальная шкала тангажа (деления 5/10°)
//     [F12.6] Окно высоты Alt с дискретной высотой altStep_m
//     [F12.7] Верхняя линейная шкала виртуального курса вокруг heading_deg
//     [F12.8] Численный крен (нижний левый угол)
//     [F12.9] Численный тангаж (нижний правый угол, с явным знаком)
// ============================================================================
void drawHud() {
  // Получаем текущую ширину экрана с учётом поворота (setRotation()).
  const int16_t W = tft.width();    // фактическая ширина видимой области TFT

  // Аналогично по высоте: учитываем ориентацию дисплея.
  const int16_t H = tft.height();   // фактическая высота видимой области TFT

  // Полностью очищаем экран, заливая его цветом фона HUD.
  // Это убирает артефакты от предыдущего кадра.
  tft.fillScreen(COL_FON1);

  // Сохраняем основной цвет HUD-графики в отдельную переменную,
  // чтобы не дублировать константу ST77XX_GREEN везде ниже.
  uint16_t hudColor = ST77XX_GREEN; // зелёный цвет линий и текста HUD

  // Задаём X-координату центра HUD / самолёта:
  // берём геометрический центр и немного смещаем влево,
  // чтобы справа освободить место под вертикальную шкалу и окно высоты.
  int16_t cx = W / 2 - 16;          // центр HUD по X

  // Задаём Y-координату центра HUD / самолёта:
  // берём середину высоты и слегка сдвигаем вниз,
  // чтобы сверху уместить шкалу курса, а снизу – численные значения.
  int16_t cy = H / 2 + 4;           // центр HUD по Y

  // Готовим тангаж для экранной геометрии:
  // меняем знак, чтобы при положительном тангаже (нос вверх)
  // линия горизонта на экране смещалась вниз.
  float pitch_vis = -pitch_deg;     // тангаж в «экранной» системе координат

  // Переводим крен из градусов в радианы для использования в sin()/cos().
  float roll_rad  = roll_deg * PI / 180.0f;  // крен в радианах


  // --------------------------------------------------------------------------
  // [F12.1] Основная линия горизонта (по тангажу, без поворота по крену)
  // --------------------------------------------------------------------------

  // Рассчитываем вертикальное смещение базовой линии горизонта
  // в пикселях как тангаж * масштаб пикселей на градус.
  int16_t pitchOffsetY = (int16_t)(pitch_vis * PITCH_PX_PER_DEG);

  // Определяем итоговую Y-координату горизонтальной линии горизонта.
  int16_t hy = cy + pitchOffsetY;

  // Левый отступ линии горизонта от края экрана.
  const int16_t horizMarginLeft   = 6;

  // Отступ справа для вертикальной шкалы тангажа,
  // чтобы линия горизонта не пересекалась с ней.
  const int16_t horizToPitchScale = 10;

  // Рабочая ширина HUD-области: немного меньше полной ширины экрана.
  const int16_t scaleX = W - 20;

  // X-координата левого конца горизонтальной линии.
  int16_t hx1 = horizMarginLeft;

  // X-координата правого конца горизонтальной линии
  // (чуть левее области шкалы тангажа).
  int16_t hx2 = scaleX - horizToPitchScale;

  // Рисуем основную горизонтальную линию горизонта по рассчитанным координатам.
  tft.drawLine(hx1, hy, hx2, hy, hudColor);

  // --------------------------------------------------------------------------
  // [F12.2] Дуга крена (-90..+90°) с рисками и крайними стрелками
  // --------------------------------------------------------------------------

  // Задаём радиус дуги, по которой будут располагаться риски крена.
  const int16_t br_r  = 35;

  // Центр дуги по X совмещаем с центром самолёта.
  const int16_t br_cx = cx;

  // Центр дуги по Y также привязываем к центру самолёта (можно сместить при желании).
  const int16_t br_cy = cy + 0;

  // Проходим по углам крена от -90 до +90 градусов с шагом 30°,
  // на каждом шаге рисуем либо простую рискку, либо «стрелку» на краях.
  for (int a = -90; a <= 90; a += 30) {
    // Преобразуем угол из «шкальной» системы (-90..+90)
    // к углу в радианах относительно центра дуги.
    float ang = (a + 90.0f) * PI / 180.0f;

    // Вычисляем координаты точки на дуге (внутренний конец метки).
    float cx1 = br_cx + br_r * cos(ang);
    float cy1 = br_cy + br_r * sin(ang);

    // Вычисляем касательный вектор вдоль дуги (направление линии риски).
    float vx = cos(ang);
    float vy = sin(ang);

    // Для крайних углов (-90 и +90) рисуем специальную форму маркера – стрелку.
    if (a == -90 || a == 90) {
      // Длина выноса вершины стрелки внутрь дуги.
      const float tipLen  = 2.0f;

      // Длина «крыльев» стрелки.
      const float wingLen = 6.0f;

      // Угол, на который поворачиваем «крылья» относительно касательной.
      const float wingAng = 25.0f * PI / 180.0f;

      // Базовая точка на дуге – начало стрелки.
      float bx = cx1;
      float by = cy1;

      // Вектор, направленный внутрь дуги (против касательной).
      float ix = -vx;
      float iy = -vy;

      // Координаты вершины стрелки – немного внутрь дуги.
      float tx = bx + ix * tipLen;
      float ty = by + iy * tipLen;

      // Сразу вычисляем cos/sin поворотного угла для крыльев.
      float cosW = cos(wingAng);
      float sinW = sin(wingAng);

      // Левое крыло – поворот касательного вектора на +wingAng.
      float lxv = vx * cosW - vy * sinW;
      float lyv = vx * sinW + vy * cosW;

      // Правое крыло – поворот касательного вектора на -wingAng.
      float rxv = vx * cosW + vy * sinW;
      float ryv = -vx * sinW + vy * cosW;

      // Округляем координаты вершины стрелки до целых пикселей.
      int16_t tipX = (int16_t)tx;
      int16_t tipY = (int16_t)ty;

      // Конечная точка левого крыла стрелки.
      int16_t lX = (int16_t)(tx + lxv * wingLen);
      int16_t lY = (int16_t)(ty + lyv * wingLen);

      // Конечная точка правого крыла стрелки.
      int16_t rX = (int16_t)(tx + rxv * wingLen);
      int16_t rY = (int16_t)(ty + ryv * wingLen);

      // Рисуем левую грань стрелки от вершины к концу крыла.
      tft.drawLine(tipX, tipY, lX, lY, hudColor);

      // Рисуем правую грань стрелки.
      tft.drawLine(tipX, tipY, rX, rY, hudColor);

    } else {
      // Для углов, отличных от ±90°, рисуем обычные короткие метки.

      // Для центральной метки (0°) длина деления больше,
      // чтобы её было проще визуально выделить.
      int len = (a == 0) ? 7 : 5;

      // Внутренний конец метки – сама точка на дуге.
      int16_t x1 = (int16_t)cx1;
      int16_t y1 = (int16_t)cy1;

      // Внешний конец метки на радиусе (br_r + len).
      int16_t x2 = br_cx + (int16_t)((br_r + len) * cos(ang));
      int16_t y2 = br_cy + (int16_t)((br_r + len) * sin(ang));

      // Рисуем метку от дуги наружу.
      tft.drawLine(x1, y1, x2, y2, hudColor);
    }
  }

   // --------------------------------------------------------------------------
  // [F12.3] Вторая линия горизонта, наклонённая по текущему крену
  // --------------------------------------------------------------------------

  // Задаём вертикальный сдвиг второй линии относительно первой.
  const int16_t horizOffset = -10;

  // Вычисляем Y-координату второй линии горизонта.
  int16_t hy2 = hy + horizOffset;

  // Центр второй линии по X размещаем по центру экрана,
  // а по Y – на высоте hy2.
  float cx2 = W / 2.0f;
  float cy2 = (float)hy2;

  // Угол наклона второй линии: берём крен с обратным знаком
  // для правильного визуального поворота.
  float roll2 = -roll_rad;

  // Длина полуотрезка, которую откладываем в обе стороны от центра.
  float lineLen2 = W;

  // Смещение по X для одного конца линии при данном наклоне.
  float dx2 = cos(roll2) * lineLen2;

  // Смещение по Y для одного конца линии.
  float dy2 = sin(roll2) * lineLen2;

  // Координаты левого конца наклонной линии.
  int16_t x1_2 = (int16_t)(cx2 - dx2);
  int16_t y1_2 = (int16_t)(cy2 - dy2);

  // Координаты правого конца наклонной линии.
  int16_t x2_2 = (int16_t)(cx2 + dx2);
  int16_t y2_2 = (int16_t)(cy2 + dy2);

  // Рисуем вторую линию горизонта – наклонённую по крену.
  tft.drawLine(x1_2, y1_2, x2_2, y2_2, hudColor);


  // --------------------------------------------------------------------------
  // [F12.4] Самолёт (крылья + киль) в центре HUD
  // --------------------------------------------------------------------------

  // Лямбда-функция для поворота произвольной точки (x,y)
  // на угол roll_rad вокруг центра (cx, cy) и получения X-координаты.
  auto rotX = [&](float x, float y) -> int16_t {
    return (int16_t)(x * cos(roll_rad) - y * sin(roll_rad)) + cx;
  };

  // Аналогичная лямбда для получения Y-координаты повёрнутой точки.
  auto rotY = [&](float x, float y) -> int16_t {
    return (int16_t)(x * sin(roll_rad) + y * cos(roll_rad)) + cy;
  };

  // Полуразмах крыльев самолёта.
  const float wingHalfLen = 26.0f;

  // Ширина «разрыва» между левым и правым крылом в центре.
  const float centerGap   = 6.0f;

  // Глубина V-образного «зубчика» на каждом полукрыле.
  const float toothDepth  = 4.0f;

  // Положение середины левого крыла между -wingHalfLen и -centerGap.
  float leftMid = (-wingHalfLen + (-centerGap)) * 0.5f;

  // Рисуем левое крыло: от крайней точки к зубчику и к центру.

  // Сегмент от крайней левой точки до точки перед V‑образным зубчиком.
  tft.drawLine(
    rotX(-wingHalfLen, 0), rotY(-wingHalfLen, 0),
    rotX(leftMid - 2,  0), rotY(leftMid - 2,  0),
    hudColor
  );

  // Левая грань V‑образного зубчика.
  tft.drawLine(
    rotX(leftMid - 2,  0),         rotY(leftMid - 2,  0),
    rotX(leftMid,     toothDepth), rotY(leftMid,     toothDepth),
    hudColor
  );

  // Правая грань зубчика – возвращаемся к уровню крыла.
  tft.drawLine(
    rotX(leftMid,     toothDepth), rotY(leftMid,     toothDepth),
    rotX(leftMid + 2, 0),          rotY(leftMid + 2, 0),
    hudColor
  );

  // Сегмент от зубчика до края центрального разрыва.
  tft.drawLine(
    rotX(leftMid + 2, 0), rotY(leftMid + 2, 0),
    rotX(-centerGap,  0), rotY(-centerGap,  0),
    hudColor
  );

  // Аналогичная средняя точка для правого крыла между centerGap и +wingHalfLen.
  float rightMid = (wingHalfLen + centerGap) * 0.5f;

  // Рисуем правое крыло (зеркально относительно левого).

  tft.drawLine(
    rotX( wingHalfLen, 0), rotY( wingHalfLen, 0),
    rotX( rightMid + 2, 0), rotY( rightMid + 2, 0),
    hudColor
  );

  tft.drawLine(
    rotX( rightMid + 2, 0),         rotY( rightMid + 2, 0),
    rotX( rightMid,     toothDepth), rotY( rightMid,     toothDepth),
    hudColor
  );

  tft.drawLine(
    rotX( rightMid,     toothDepth), rotY( rightMid,     toothDepth),
    rotX( rightMid - 2, 0),          rotY( rightMid - 2, 0),
    hudColor
  );

  tft.drawLine(
    rotX( rightMid - 2, 0), rotY( rightMid - 2, 0),
    rotX( centerGap,    0), rotY( centerGap,    0),
    hudColor
  );

  // Разрыв киля по Y (привязан к ширине центрального зазора).
  const float keelGap   = centerGap;

  // Верхняя точка киля относительно центра самолёта.
  float keelTopY    = -20.0f;

  // Нижняя точка киля – немного выше центра (по модулю centerGap).
  float keelBottomY = -keelGap;

  // Рисуем вертикальный киль самолёта, повёрнутый по крену.
  tft.drawLine(
    rotX(0, keelTopY),    rotY(0, keelTopY),
    rotX(0, keelBottomY), rotY(0, keelBottomY),
    hudColor
  );

  // --------------------------------------------------------------------------
  // [F12.5] Правая вертикальная шкала тангажа
  // --------------------------------------------------------------------------

  // Масштаб по Y: сколько пикселей соответствует одному градусу тангажа.
  const float  pixelsPerDeg = 2.8f;

  // Длина большой риски (для кратных 10°).
  const int    majorLen     = 6;

  // Длина маленькой риски (для кратных 5°, но не 10°).
  const int    minorLen     = 3;

  // Теоретический диапазон меток по тангажу (±maxDeg).
  const int    maxDeg       = 180;

  // Центр окна шкалы по Y (привязан к центру самолёта).
  const int16_t winCenterY = cy;

  // Половина высоты окна шкалы.
  const int16_t winHalfH   = 40;

  // Верхняя граница окна отображения шкалы.
  const int16_t winTopY    = winCenterY - winHalfH;

  // Нижняя граница окна отображения шкалы.
  const int16_t winBotY    = winCenterY + winHalfH;

  // Настраиваем цвет и размер шрифта для подписей шкалы тангажа.
  tft.setTextColor(hudColor, COL_FON1);
  tft.setTextSize(1);

  // Рисуем крупные деления шкалы (каждые 10 градусов) с числовыми подписями.
  for (int mark = -maxDeg; mark <= maxDeg; mark += 10) {
    // Вычисляем вертикальное смещение метки относительно текущего pitch_vis.
    float dy = (pitch_vis - (float)mark) * pixelsPerDeg;

    // Переводим смещение в итоговую Y-координату метки.
    int16_t my = (int16_t)(winCenterY + dy);

    // Пропускаем метки, которые выходят за пределы видимого окна.
    if (my < winTopY || my > winBotY) continue;

    // X-координаты левого и правого конца большой риски.
    int16_t mx1 = scaleX - majorLen / 2;
    int16_t mx2 = scaleX + majorLen / 2;

    // Рисуем горизонтальную линию деления.
    tft.drawLine(mx1, my, mx2, my, hudColor);

    // Отступы для текста справа от риски.
    const int16_t rightMargin   = 4;
    const int16_t gapFromStick  = 4;

    // Базовый X для подписи – немного правее правого конца риски.
    int16_t tx = mx2 + gapFromStick;

    // Максимально допустимый X, чтобы текст не вышел за правый край экрана.
    int16_t maxTx = W - rightMargin - 10;
    if (tx > maxTx) tx = maxTx;

    // Базовый Y для текста – чуть выше центра риски.
    int16_t ty = my - 3;

    // Корректируем по верхней границе окна.
    if (ty < winTopY)     ty = winTopY;

    // Корректируем по нижней границе окна с запасом под высоту шрифта.
    if (ty > winBotY - 8) ty = winBotY - 8;

    // Устанавливаем курсор в рассчитанную позицию.
    tft.setCursor(tx, ty);

    // Для нулевой метки выводим «0», для остальных – модуль значения.
    int val = (mark == 0) ? 0 : abs(mark);

    // Печатаем числовое значение градуса.
    tft.print(val);
  }

  // Рисуем мелкие деления шкалы (каждые 5 градусов) без подписей.
  for (int mark = -maxDeg; mark <= maxDeg; mark += 5) {
    // Пропускаем метки, которые уже использовались как большие (10°).
    if (mark % 10 == 0) continue;

    // Вычисляем вертикальное смещение метки.
    float dy = (pitch_vis - (float)mark) * pixelsPerDeg;

    // Переводим его в Y-координату.
    int16_t my = (int16_t)(winCenterY + dy);

    // Если метка выходит за окно, пропускаем её.
    if (my < winTopY || my > winBotY) continue;

    // X-координаты левого и правого конца мелкой риски.
    int16_t mx1 = scaleX - minorLen / 2;
    int16_t mx2 = scaleX + minorLen / 2;

    // Рисуем короткую горизонтальную метку.
    tft.drawLine(mx1, my, mx2, my, hudColor);
  }

  // --------------------------------------------------------------------------
  // [F12.6] Окно высоты Alt (используется altStep_m)
  // --------------------------------------------------------------------------
  {
    // Размеры прямоугольника окна высоты.
    const int16_t altBoxWidth  = 34;
    const int16_t altBoxHeight = 16;

    // Отступ окна от правого края дисплея.
    const int16_t rightMargin = 2;

    // Вычисляем правую границу окна по X.
    int16_t altBoxX2 = W - rightMargin;

    // Левая граница окна по X – отступ назад на ширину окна.
    int16_t altBoxX1 = altBoxX2 - altBoxWidth;

    // Базовое положение окна по Y – чуть отступаем от верхнего края.
    int16_t altBoxY = 4;

    // Если по какой-то причине окно вылезает за нижнюю границу,
    // то поджимаем его вверх.
    if (altBoxY + altBoxHeight > H) {
      altBoxY = H - altBoxHeight - 1;
    }

    // Рисуем прямоугольную рамку окна высоты.
    tft.drawRect(altBoxX1, altBoxY, altBoxWidth, altBoxHeight, hudColor);

    // Устанавливаем параметры текста для значения высоты.
    tft.setTextColor(hudColor, COL_FON1);
    tft.setTextSize(1);

    // Берём текущее «лестничное» значение высоты.
    float altPrint_m = altStep_m;

    // Буфер для форматированной строки с высотой.
    char valBuf[8];

    // Формируем строку высоты с одной цифрой после запятой.
    snprintf(valBuf, sizeof(valBuf), "%.1f", altPrint_m);

    // Вычисляем габариты текста, чтобы аккуратно разместить его в окне.
    int16_t bx, by;
    uint16_t bw, bh;
    tft.getTextBounds(valBuf, 0, 0, &bx, &by, &bw, &bh);

    // Вычисляем X так, чтобы текст был прижат к правой стороне окна.
    int16_t valTextX = altBoxX2 - 2 - bw;

    // По Y размещаем текст примерно по вертикальному центру окна.
    int16_t valTextY = altBoxY + (altBoxHeight - bh) / 2;

    // Если получилось слишком близко к левому краю,
    // немного сдвигаем вправо.
    if (valTextX < altBoxX1 + 1) valTextX = altBoxX1 + 1;

    // Устанавливаем курсор и выводим значение высоты.
    tft.setCursor(valTextX, valTextY);
    tft.print(valBuf);

    // Подпись окна высоты.
    const char *labelAlt = "Alt";

    // Вычисляем размеры подписи "Alt".
    int16_t l1x, l1y;
    uint16_t l1w, l1h;
    tft.getTextBounds(labelAlt, 0, 0, &l1x, &l1y, &l1w, &l1h);

    // Центрируем подпись по горизонтали относительно окна.
    int16_t labelAltX = altBoxX1 + (altBoxWidth - l1w) / 2;

    // Размещаем подпись под окном с небольшим отступом.
    int16_t labelAltY = altBoxY + altBoxHeight + 3;

    // Следим, чтобы подпись не вылезла за нижнюю границу экрана.
    if (labelAltY > H - l1h - 1) labelAltY = H - l1h - 1;

    // Выводим подпись "Alt".
    tft.setCursor(labelAltX, labelAltY);
    tft.print(labelAlt);
  }


  // --------------------------------------------------------------------------
  // [F12.7] Верхняя шкала виртуального курса (heading_deg)
  // --------------------------------------------------------------------------

  // Берём текущее значение виртуального курса.
  float hdg = heading_deg;

  // Нормализуем его в диапазон -180..+180°, чтобы удобно работать с подписями.
  while (hdg >  180.0f) hdg -= 360.0f;
  while (hdg <= -180.0f) hdg += 360.0f;

  // Y-координата базовой линии шкалы курса.
  int16_t hs_y  = 16;

  // Центр шкалы по X совпадает с центром самолёта.
  int16_t hs_cx = cx;

  // Полудлина линейки шкалы.
  int16_t halfLenH2 = 28;

  // Левый край шкалы курса.
  int16_t hs_left  = hs_cx - halfLenH2;

  // Правый край шкалы курса.
  int16_t hs_right = hs_cx + halfLenH2;

  // Страхуемся от выхода линии за левую рамку экрана.
  if (hs_left < 4) hs_left = 4;

  // Страхуемся от выхода линии за правую рамку экрана.
  if (hs_right > W - 4) hs_right = W - 4;

  // Рисуем саму горизонтальную линию шкалы курса.
  tft.drawLine(hs_left, hs_y, hs_right, hs_y, hudColor);

  // Высота треугольника-указателя.
  int16_t tri_h = 6;

  // Ширина основания треугольника.
  int16_t tri_w = 8;

  // Вершина указателя по X совпадает с центром шкалы.
  int16_t vx0 = hs_cx;

  // Вершина немного ниже линии шкалы.
  int16_t vy0 = hs_y + 2;

  // Y-координата основания треугольника.
  int16_t bx_y = vy0 + tri_h;

  // Левая точка основания треугольника.
  int16_t bx_l = vx0 - tri_w / 2;

  // Правая точка основания треугольника.
  int16_t bx_r = vx0 + tri_w / 2;

  // Рисуем левую грань треугольника-указателя.
  tft.drawLine(vx0, vy0, bx_l, bx_y, hudColor);

  // Рисуем правую грань треугольника.
  tft.drawLine(vx0, vy0, bx_r, bx_y, hudColor);

  // Рисуем основание треугольника.
  tft.drawLine(bx_l, bx_y, bx_r, bx_y, hudColor);

  // Шаг делений шкалы по курсу (каждые 5°).
  int   stepDeg   = 5;

  // Масштаб по X: сколько пикселей на один градус курса.
  float pxPerDegH = 2.3f;

  // Диапазон в градусах вокруг текущего курса, отображаемый на шкале.
  int   rangeDeg  = 20;

  // Центр шкалы по градусам – округляем курс до ближайшего целого.
  int centerDeg = (int)round(hdg);

  // Начальное значение делений по шкале.
  int startDeg  = centerDeg - rangeDeg;

  // Конечное значение делений по шкале.
  int endDeg    = centerDeg + rangeDeg;

  // Настройки шрифта и цвета для подписей курса.
  tft.setTextSize(1);
  tft.setTextColor(hudColor, COL_FON1);

  // Рисуем деления и подписи по курсу (кроме центрального нуля).
  for (int mark = startDeg; mark <= endDeg; mark += stepDeg) {
    // Разница между меткой и центральным значением курса.
    int d = mark - centerDeg;

    // Смещение метки по X в пикселях относительно центра шкалы.
    int16_t x = hs_cx + (int16_t)(d * pxPerDegH);

    // Пропускаем метку, если она ушла за границы шкалы.
    if (x < hs_left || x > hs_right) continue;

    // Длина вертикальной риски деления.
    int16_t len = 4;

    // Рисуем короткую вертикальную метку над линией шкалы.
    tft.drawLine(x, hs_y, x, hs_y - len, hudColor);

    // Каждую вторую метку (то есть через 10°) подписываем числом.
    if (((mark / stepDeg) % 2) == 0) {
      // Берём значение метки в градусах.
      int val = mark;

      // Нормализуем его в диапазон -180..+180.
      while (val >  180) val -= 360;
      while (val <= -180) val += 360;

      // Центральный ноль не подписываем здесь (он будет нарисован отдельно).
      if (val == 0) continue;

      // Базовый X для подписи – чуть влево от линии метки.
      int16_t tx = x - 8;

      // Базовый Y для подписи – над верхом риски.
      int16_t ty = hs_y - len - 8;

      // Страхуемся от выхода текста за левый край экрана.
      if (tx < 0) tx = 0;

      // Страхуемся от выхода текста за правый край экрана.
      if (tx > W - 16) tx = W - 16;

      // Страхуемся от выхода текста за верх экрана.
      if (ty < 0) ty = 0;

      // Устанавливаем курсор в позицию подписи.
      tft.setCursor(tx, ty);

      // Печатаем значение курса для данной метки.
      tft.print(val);
    }
  }

  // Дополнительно выводим центральный «0» курса строго под треугольником.
  {
    // Длина риски, от которой отступаем вверх.
    int16_t len = 4;

    // Y-координата для текста «0».
    int16_t ty0 = hs_y - len - 8;

    // Страхуемся от выхода текста за верхнюю границу.
    if (ty0 < 0) ty0 = 0;

    // X-координата текста «0» – примерно по центру шкалы.
    int16_t tx0 = hs_cx - 3;

    // Страхуемся от выхода за левый край.
    if (tx0 < 0) tx0 = 0;

    // Страхуемся от выхода за правый край.
    if (tx0 > W - 8) tx0 = W - 8;

    // Устанавливаем курсор и печатаем «0» курса.
    tft.setCursor(tx0, ty0);
    tft.print(0);
  }

  // --------------------------------------------------------------------------
  // [F12.8] Численный крен (roll_deg), нижний левый угол
  // --------------------------------------------------------------------------

  // Настраиваем размер и цвет шрифта для численных показаний.
  tft.setTextSize(1);
  tft.setTextColor(hudColor, COL_FON1);

  // Отступы от левого и нижнего края для вывода крена.
  const int16_t rollTextMarginX = 20;
  const int16_t rollTextMarginY = 20;

  // X-координата текста крена – с небольшим отступом от левого края.
  int16_t rollTextX = rollTextMarginX;

  // Y-координата текста крена – чуть выше нижней границы экрана.
  int16_t rollTextY = H - rollTextMarginY;

  // Устанавливаем курсор в нужную позицию.
  tft.setCursor(rollTextX, rollTextY);

  // Печатаем текущее значение крена с одним знаком после запятой.
  tft.print(roll_deg, 1);

  // --------------------------------------------------------------------------
  // [F12.9] Численный тангаж (pitch_vis), нижний правый угол
  // --------------------------------------------------------------------------

  // Подготавливаем значение тангажа для печати (уже в экранной системе).
  float pitch_for_print = pitch_vis;

  // Локальные копии размеров экрана (для наглядности и удобства).
  int16_t w = W;
  int16_t h = H;

  // Отступы от правого и нижнего края для вывода тангажа.
  const int16_t pitchTextMarginX = 20;
  const int16_t pitchTextMarginY = 20;

  // X-координата текста тангажа – от правого края внутрь.
  int16_t pitchTextX = w - pitchTextMarginX - 26;

  // Y-координата текста тангажа – чуть выше нижней границы.
  int16_t pitchTextY = h - pitchTextMarginY;

  // Страхуемся от отрицательного X на узких дисплеях.
  if (pitchTextX < 0) pitchTextX = 0;

  // Устанавливаем курсор в позицию вывода тангажа.
  tft.setCursor(pitchTextX, pitchTextY);

  // Логика форматирования:
  //   - при положительном тангаже явно выводим знак '+';
  //   - при отрицательном выводим число как есть (со знаком '-');
  //   - при очень малых значениях вокруг нуля печатаем "0.0",
  //     чтобы не видеть дрожание от шума.
  if (pitch_for_print > 0.05f) {
    // Положительный тангаж – добавляем знак «+».
    tft.print("+");
    tft.print(pitch_for_print, 1);
  } else if (pitch_for_print < -0.05f) {
    // Отрицательный тангаж – печатаем с естественным знаком '-'.
    tft.print(pitch_for_print, 1);
  } else {
    // Малая зона вокруг нуля – считаем тангаж равным нулю.
    tft.print("0.0");
  }
}

// ============================================================================
//   [F13] updateEnvValues – обновление ENV-значений на METEO-экране
//   --------------------------------------------------------------------------
//   Функция перерисовывает ТОЛЬКО ЦИФРОВЫЕ значения на уже нарисованном
//   METEO-каркасе (см. drawEnvFrame()). Она вызывается периодически из loop()
//   с интервалом SCREEN_UPDATE_INTERVAL_METEO (обычно раз в 2 секунды).
//
//   Обновляются:
//
//     Столбец ENV:
//       - Temp:   aht_tC         (°C, с AHT20)
//       - Hydro:  aht_hR         (% влажности, с AHT20)
//       - Dew:    calcDewPoint() (°C, расчётная точка росы)
//       - Psc:    p_mmHg         (давление, мм рт. ст. с BMP280)
//       - Trend:  pressureTrend  (UP / DOWN / STEADY / N/A)
//       - T_MPU:  temp_f         (°C, температура MPU6050)
//
//     Статусы датчиков:
//       - AHT20: OK/ERR + счётчик "памяти ошибок" (ahtErrCount)
//       - BMP280: OK/ERR + bmpErrCount
//       - MPU:    OK/ERR + mpuErrCount
// ============================================================================
void updateEnvValues() {
  // Общие настройки текста для значений
  tft.setTextWrap(false);                 // без автоматического переноса строк
  tft.setTextColor(COL_TEXT11, COL_FON1); // жёлтый текст на фиолетовом фоне
  tft.setTextSize(OSN_TEXT);              // основной размер шрифта

  // --------------------------------------------------------------------------
  // Температура воздуха (AHT20) – строка "Temp:"
  // --------------------------------------------------------------------------
  tft.setCursor(SMESH_L4, 20);            // позиция значения справа от "Temp:"
  tft.print("           ");               // "затираем" старое значение пробелами
  tft.setCursor(SMESH_L4, 20);            // возвращаем курсор в начало поля

  if (aht_ok) {
    // Если AHT20 в строю – выводим температуру с одной цифрой после запятой
    tft.print(aht_tC, 1);
    tft.print(" C");
  } else {
    // Если AHT20 в ошибке – вместо числа показываем "ERR"
    tft.print("ERR");
  }

  // --------------------------------------------------------------------------
  // Влажность воздуха (AHT20) – строка "Hydro:"
  // --------------------------------------------------------------------------
  tft.setCursor(SMESH_L4, 35);
  tft.print("           ");               // очищаем поле
  tft.setCursor(SMESH_L4, 35);

  if (aht_ok) {
    // Влажность в процентах, без дробной части
    tft.print(aht_hR, 0);
    tft.print(" %");
  } else {
    tft.print("ERR");
  }

  // --------------------------------------------------------------------------
  // Точка росы (расчёт по температуре и влажности) – строка "Dew:"
  // --------------------------------------------------------------------------
  tft.setCursor(SMESH_L4, 50);
  tft.print("           ");
  tft.setCursor(SMESH_L4, 50);

  if (aht_ok) {
    // Если AHT20 OK – считаем точку росы по calcDewPoint()
    float dew = calcDewPoint(aht_tC, aht_hR);
    tft.print(dew, 1);
    tft.print(" C");
  } else {
    tft.print("ERR");
  }

  // --------------------------------------------------------------------------
  // "Комфорт" по температуре и влажности – справа от строки "Hydro:"
  // --------------------------------------------------------------------------
  // Тут мы печатаем короткий текст:
  //   DRY   – слишком сухо
  //   HUMID – слишком влажно (и тепло)
  //   OK    – комфортная зона
  //   N/A   – нет данных
  tft.setCursor(SMESH_L3 + 90, 35);       // правый блок напротив Hydro
  tft.print("        ");                  // очищаем поле
  tft.setCursor(SMESH_L3 + 90, 35);

  if (aht_ok) {
    ComfortState cs = getComfortState(aht_tC, aht_hR);
    if (cs == C_STATE_DRY)         tft.print("DRY");
    else if (cs == C_STATE_HUMID)  tft.print("HUMID");
    else                           tft.print("OK");
  } else {
    tft.print("N/A");              // AHT20 не работает – комфорт оценить нельзя
  }

  // --------------------------------------------------------------------------
  // Давление (BMP280) – строка "Psc:"
  // --------------------------------------------------------------------------
  tft.setCursor(SMESH_L4, 65);
  tft.print("           ");
  tft.setCursor(SMESH_L4, 65);

  if (bmp_ok) {
    // Давление p_mmHg уже посчитано из BMP в мм рт. ст.
    tft.print(p_mmHg, 0);
    tft.print("mmH");
  } else {
    tft.print("ERR");
  }

  // --------------------------------------------------------------------------
  // Состояние давления (LOW / HIGH / NORM) – справа от "Psc:"
  // --------------------------------------------------------------------------
  tft.setCursor(SMESH_L3 + 90, 65);
  tft.print("        ");
  tft.setCursor(SMESH_L3 + 90, 65);

  if (bmp_ok) {
    PressureState ps = getPressureState(p_mmHg);
    if (ps == P_STATE_LOW)       tft.print("LOW");   // ниже P_LOW
    else if (ps == P_STATE_HIGH) tft.print("HIGH");  // выше P_HIGH
    else                         tft.print("NORM");  // между порогами
  } else {
    tft.print("N/A");
  }

  // --------------------------------------------------------------------------
  // Тренд давления (Trend:) – UP / DOWN / STEADY / N/A
  // --------------------------------------------------------------------------
  tft.setCursor(SMESH_L4, 80);
  tft.print("           ");
  tft.setCursor(SMESH_L4, 80);

  if (bmp_ok) {
    // pressureTrend обновляется в [F18.4] примерно раз в 10 минут
    if (pressureTrend == T_STATE_RISE)        tft.print("UP");
    else if (pressureTrend == T_STATE_FALL)   tft.print("DOWN");
    else if (pressureTrend == T_STATE_STEADY) tft.print("STEADY");
    else                                      tft.print("N/A"); // ещё не посчитан
  } else {
    tft.print("N/A");
  }

  // --------------------------------------------------------------------------
  // Температура MPU (T_MPU:) – по фильтрованному temp_f
  // --------------------------------------------------------------------------
  tft.setCursor(SMESH_L4, 95);
  tft.print("           ");
  tft.setCursor(SMESH_L4, 95);

  if (mpu_ok) {
    // temp_f – уже сглаженная температура MPU, вычисленная из tempRaw
    tft.print(temp_f, 1);
    tft.print(" C");
  } else {
    tft.print("ERR");
  }

  // --------------------------------------------------------------------------
  // Статусы датчиков внизу экрана (AHT20 / BMP280 / MPU)
  //   Формат: "OK/ERR (mERR=<счётчик ошибок>)"
  // --------------------------------------------------------------------------

  // --- Статус AHT20 ---
  tft.setCursor(SMESH_L3 + 40, 120);      // строка "AHT20:"
  tft.print("                    ");      // очищаем длинное поле
  tft.setCursor(SMESH_L3 + 40, 120);

  if (aht_ok) tft.print("OK ");
  else        tft.print("ERR");
  tft.print(" (mERR="); tft.print(ahtErrCount); tft.print(")");

  // --- Статус BMP280 ---
  tft.setCursor(SMESH_L3 + 40, 132);      // строка "BMP280:"
  tft.print("                    ");
  tft.setCursor(SMESH_L3 + 40, 132);

  if (bmp_ok) tft.print("OK ");
  else        tft.print("ERR");
  tft.print(" (mERR="); tft.print(bmpErrCount); tft.print(")");

  // --- Статус MPU6050 ---
  tft.setCursor(SMESH_L3 + 40, 144);      // строка "MPU:"
  tft.print("                    ");
  tft.setCursor(SMESH_L3 + 40, 144);

  if (mpu_ok) tft.print("OK ");
  else        tft.print("ERR");
  tft.print(" (mERR="); tft.print(mpuErrCount); tft.print(")");
}

// ============================================================================
//   [F13.1] pollEnvOnce – один опрос AHT/BMP + обработка высоты
//   --------------------------------------------------------------------------
//   Вызывается из loop() как в METEO-режиме, так и в HUD-режиме,
//   но с разной частотой ([F18.3]).
//
//   Делает:
//     1) Чтение температуры/влажности с AHT20.
//     2) Чтение давления/высоты с BMP280.
//     3) Обновление p_mmHg (давление в мм рт. ст.).
//     4) Обновление altitude_m (сырая относительная высота).
//     5) Сглаживание высоты в altitude_m_f (фильтр по баро).
//     6) Обновление "лестницы" высоты altStep_m и состояния altState.
//
//   При серьёзной ошибке ENV вызывает reinitAllSensors().
// ============================================================================
void pollEnvOnce() {
  sensors_event_t humidity, temp;

  // Пытаемся получить событие от AHT20: и температуру, и влажность.
  if (aht.getEvent(&humidity, &temp)) {
    // AHT20 ответил успешно – сохраняем его данные.
    aht_tC = temp.temperature;            // температура воздуха (°C)
    aht_hR = humidity.relative_humidity;  // относительная влажность (%)

    // Дальше работаем только если BMP280 тоже в порядке.
    if (bmp_ok) {
      // Фиксируем время чтения BMP – пригодится для диагностики ошибок MPU.
      unsigned long t_bmp = millis();
      lastBmpReadMs = t_bmp;
      Serial.print("BMP read at ms=");
      Serial.println(t_bmp);

      // ----------------------------------------------------------------------
      // 1) Чтение давления и пересчёт в мм рт. ст.
      // ----------------------------------------------------------------------
      float pPa   = bmp.readPressure();    // давление в Паскалях
      float p_hPa = pPa / 100.0f;          // перевод в гПа (hPa)
      p_mmHg      = p_hPa * 0.75006f;      // перевод в мм рт. ст. (для METEO-индикации)

      // ----------------------------------------------------------------------
      // 2) Чтение высоты и расчёт относительной высоты altitude_m
      // ----------------------------------------------------------------------
      // bmp.readAltitude(SEA_LEVEL_HPA) возвращает "абсолютную" высоту в метрах
      // относительно уровня моря при заданном опорном давлении SEA_LEVEL_HPA.
      float alt_abs = bmp.readAltitude(SEA_LEVEL_HPA);

      // altitudeOffset_m – "нулевая" высота по месту установки,
      // полученная в setup() усреднением нескольких измерений.
      // Вычитая её, получаем относительную высоту altitude_m.
      altitude_m = alt_abs - altitudeOffset_m;

      // ----------------------------------------------------------------------
      // [F13.1.1] Сглаживание баро (altitude_m_f) и захват нулевой высоты altZeroRef
      // ----------------------------------------------------------------------
      // В первые ALT_STAB_MS миллисекунд после старта (10 с) мы считаем,
      // что высота ещё "плавает" от шума и калибровки: inStab == true.
      // В этот период:
      //   - сбрасываем altZeroRefSet;
      //   - держим altitude_m_f и altStep_m в 0;
      //   - не считаем "лестницу".
      bool inStab = (millis() - startTime) < ALT_STAB_MS;

      // Коэффициент сглаживания баро (отдельный от alpha MPU):
      //   можно уменьшить до 0.25 для более плавной высоты.
      const float alpha_bar = 0.5f;   // 0..1, чем меньше – тем плавнее высота

      if (inStab) {
        // Период стабилизации: всё по высоте считаем нулями.
        altitude_m_f  = 0.0f;
        altZeroRefSet = false;
        altStep_m     = 0.0f;
        altLock_m     = 0.0f;
        altState      = ALT_IDLE;
      } else {
        // Вышли из периода стабилизации.
        // Если ещё не зафиксирован ноль высоты – делаем это один раз.
        if (!altZeroRefSet) {
          // Захватываем текущую относительную высоту altitude_m как "нулевую".
          altZeroRef    = altitude_m;
          altZeroRefSet = true;

          // Инициализируем сглаженную высоту и лестничную высоту.
          altitude_m_f  = altitude_m;
          altStep_m     = 0.0f;
          altLock_m     = 0.0f;
          altState      = ALT_IDLE;

          Serial.print("Alt zero ref captured: ");
          Serial.println(altZeroRef);
        }

        // Сглаживаем текущую относительную высоту:
        //   altitude_m_f = старое + alpha_bar * (новое - старое)
        altitude_m_f = altitude_m_f + alpha_bar * (altitude_m - altitude_m_f);
      }

      // ----------------------------------------------------------------------
      // [F13.1.2] "ЛЕСТНИЦА" ВЫСОТЫ ТОЛЬКО ПО БАРОМЕТРУ
      // ----------------------------------------------------------------------
      // Здесь мы из сглаженной высоты altitude_m_f формируем "лестничную"
      // высоту altStep_m для отображения в HUD:
      //
      //   - altZeroRefSet == true  -> есть опорный ноль;
      //   - !inStab                -> вышли из периода стабилизации;
      //   - alt_rel = altitude_m_f - altZeroRef -> текущая относительная высота.
      //
      // Используем состояние altState (ALT_IDLE / MOVING_UP / MOVING_DOWN) и
      // порог ALT_DIR_THRESH по dAlt, чтобы:
      //   - не реагировать на мелкий шум уровня "2 см";
      //   - фиксировать устойчивые движения вверх/вниз.
      if (altZeroRefSet && !inStab) {
        float alt_rel = altitude_m_f - altZeroRef;  // относительная высота (м)

        // last_alt_rel – статическая переменная, в которой храним
        // высоту с предыдущего вызова pollEnvOnce().
        static float last_alt_rel = 0.0f;
        float dAlt = alt_rel - last_alt_rel;        // изменение высоты за интервал
        last_alt_rel = alt_rel;

        // baroUp/baroDown – флаги динамики по высоте:
        //   baroUp   == true,  если dAlt >  ALT_DIR_THRESH  (устойчивый подъём)
        //   baroDown == true,  если dAlt < -ALT_DIR_THRESH  (устойчивое снижение)
        bool baroUp   = (dAlt >  ALT_DIR_THRESH);
        bool baroDown = (dAlt < -ALT_DIR_THRESH);

        // Машина состояний "лестницы":
        //   ALT_IDLE       – нет заметного движения по высоте;
        //   ALT_MOVING_UP  – фиксируем устойчивое движение вверх;
        //   ALT_MOVING_DOWN– фиксируем устойчивое движение вниз.
        switch (altState) {
          case ALT_IDLE:
            // В состоянии покоя, если обнаружили движение вверх/вниз –
            // переходим в соответствующее состояние.
            if (baroUp) {
              altState = ALT_MOVING_UP;
            } else if (baroDown) {
              altState = ALT_MOVING_DOWN;
            }
            break;

          case ALT_MOVING_UP:
            // Уже считаем, что движемся вверх:
            if (baroUp) {
              // Продолжаем устойчивый подъём – добавляем dAlt к altStep_m.
              altStep_m += dAlt;
            } else if (!baroUp && !baroDown) {
              // Движение прекратилось (ни вверх, ни вниз) – фиксируем текущий
              // уровень altStep_m как "застывшую" высоту и переходим в IDLE.
              altLock_m = altStep_m;
              altState  = ALT_IDLE;
            } else if (baroDown) {
              // Направление сменилось на "вниз" – переключаемся на MOVING_DOWN.
              altState = ALT_MOVING_DOWN;
            }
            break;

          case ALT_MOVING_DOWN:
            // Уже считаем, что движемся вниз:
            if (baroDown) {
              // Продолжаем устойчивое снижение – добавляем dAlt (отрицательное)
              // к altStep_m. Следим, чтобы не уйти ниже 0.
              altStep_m += dAlt;
              if (altStep_m < 0.0f) altStep_m = 0.0f;
            } else if (!baroUp && !baroDown) {
              // Движение прекратилось – немного "чистим" мелкие отрицательные
              // значения и фиксируем ступень.
              if (altStep_m < 0.1f) altStep_m = 0.0f; // очень маленькое значение приравниваем к нулю
              altLock_m = altStep_m;
              altState  = ALT_IDLE;
            } else if (baroUp) {
              // Направление сменилось на "вверх" – переходим в MOVING_UP.
              altState = ALT_MOVING_UP;
            }
            break;
        }

        // Защита от выхода altStep_m за разумные пределы:
        if (altStep_m < 0.0f) altStep_m = 0.0f;
        if (altStep_m > 5.0f) altStep_m = 5.0f;   // ограничиваем верх, например, 5 м

        // Если сейчас относительная высота близка к нулю (±0.30 м), и мы
        // в покое (ALT_IDLE), то "лестничную" высоту тоже сбрасываем в 0.
        float alt_rel_now = altitude_m_f - altZeroRef;
        if (fabs(alt_rel_now) < 0.30f && altState == ALT_IDLE) {
          altStep_m = 0.0f;
        }
      }

      // ----------------------------------------------------------------------
      // [F13.1.3] Отладка высоты (локальная, внутри pollEnvOnce)
      // ----------------------------------------------------------------------
      // Этот лог дублирует высотную информацию чаще (каждые 500 мс), чем
      // глобальный ALTLOG ([F18.7]). Можно при необходимости отключить.
      static unsigned long lastAltDebug = 0;
      if (millis() - lastAltDebug > 500) {
        lastAltDebug = millis();
        Serial.print("ALT raw=");
        Serial.print(altitude_m, 2);
        Serial.print("  alt_f=");
        Serial.print(altitude_m_f, 2);
        Serial.print("  altZero=");
        Serial.print(altZeroRef, 2);
        Serial.print("  altState=");
        Serial.print((int)altState);
        Serial.print("  altStep=");
        Serial.println(altStep_m, 2);
      }

    } else {
      // BMP280 внезапно "слетел" (bmp_ok == false не было, но чтение упало)
      // Считаем это серьёзной ошибкой и перезапускаем все датчики.
      bmp_ok = false;
      bmpErrCount++;   // увеличиваем "память ошибок" BMP
      Serial.println("BMP suddenly ERR -> reinitAllSensors()");
      reinitAllSensors("BMP sudden ERR");
    }

  } else {
    // Ошибка AHT20: getEvent() не вернул данные.
    // Считаем, что AHT вышел из строя – сразу перезапускаем все датчики.
    aht_ok = false;
    ahtErrCount++;   // "память ошибок" AHT
    Serial.println("AHT getEvent() FAILED -> reinitAllSensors()");
    reinitAllSensors("AHT error");
  }
}

// ============================================================================
//   [F14] reinitMPUOnly – "перезапуск только MPU", сейчас делается через
//                         общий сброс всех датчиков reinitAllSensors().
//   --------------------------------------------------------------------------
//   Исторически функция задумывалась как перезапуск ТОЛЬКО MPU6050, но
//   на практике оказалось надёжнее перезапускать ВСЁ (ENV + MPU) одним
//   общим действием, чтобы:
//     - синхронно выключить питание со всех датчиков;
//     - избежать "перекоса", когда одни датчики уже живы, а другие ещё нет;
//     - не городить отдельные сложные сценарии восстановления.
//
//   Поэтому сейчас reinitMPUOnly() всего лишь пишет в лог причину и
//   передаёт её в reinitAllSensors().
// ============================================================================
void reinitMPUOnly(const char* reason) {
  // Логируем, что запрошен "перезапуск MPU", но фактически будет
  // выполнен полный сброс всех датчиков через reinitAllSensors().
  Serial.print("reinitMPUOnly() -> reinitAllSensors(), reason: ");
  Serial.println(reason);

  // Выполняем общий сброс ENV + MPU.
  reinitAllSensors(reason);
}
/*
// ============================================================================
//   [F15] reinitEnvOnly – перезапуск только ENV (AHT/BMP) без MPU
//   --------------------------------------------------------------------------
//   Сейчас эта функция НЕ используется в основном коде (везде вызываем
//   reinitAllSensors()), но оставлена как задел на будущее.
//   Логика:
//     - выключить/включить питание AHT20 и BMP280;
//     - переинициализировать AHT и BMP;
//     - обновить флаги aht_ok / bmp_ok и "память ошибок".
// ============================================================================
void reinitEnvOnly(const char* reason) {
  // Логируем, что выполняем перезапуск ТОЛЬКО ENV-части
  Serial.print("Reinit ENV only (AHT/BMP), reason: ");
  Serial.println(reason);

  // Отключаем питание AHT/BMP:
  //   AHT_BMP_PWR_PIN управляет PNP BC327 (HIGH = питание выкл),
  //   SV1_INDIC_PWR_PIN – светодиод-индикатор ENV (LOW = погашен).
  digitalWrite(AHT_BMP_PWR_PIN, HIGH);   // обесточиваем AHT/BMP
  digitalWrite(SV1_INDIC_PWR_PIN, LOW);  // гасим LED ENV
  delay(300);                            // ждём, пока питание полностью "упадёт"

  // Включаем питание AHT/BMP обратно:
  //   LOW на AHT_BMP_PWR_PIN -> подаём питание,
  //   HIGH на SV1_INDIC_PWR_PIN -> зажигаем LED ENV.
  digitalWrite(AHT_BMP_PWR_PIN, LOW);    // подаём питание на AHT/BMP
  digitalWrite(SV1_INDIC_PWR_PIN, HIGH); // LED ENV вкл
  delay(200);                            // даём датчикам немного времени проснуться

  // Пытаемся снова инициализировать AHT20
  bool aht_ok_new = aht.begin();
  aht_ok = aht_ok_new;                   // обновляем глобальный флаг состояния AHT
  if (!aht_ok_new) ahtErrCount++;        // если снова неудача – увеличиваем "память ошибок" AHT

  // Пытаемся снова инициализировать BMP280 (по адресам 0x76 или 0x77)
  bool bmp_ok_new = (bmp.begin(0x76) || bmp.begin(0x77));
  bmp_ok = bmp_ok_new;                   // обновляем глобальный флаг состояния BMP
  if (!bmp_ok_new) bmpErrCount++;        // в случае неуспеха увеличиваем "память ошибок" BMP

  // Выводим итоговый статус ENV после перезапуска
  Serial.print("ENV re-init results: AHT=");
  Serial.print(aht_ok_new ? "OK" : "ERR");
  Serial.print(" BMP=");
  Serial.println(bmp_ok_new ? "OK" : "ERR");
}
*/
// ============================================================================
//   [F16] reinitAllSensors – общий ПОЛНЫЙ сброс AHT/BMP + MPU
//   Используется при серьёзных ошибках ENV или MPU:
//     - полностью выключаем питание всех датчиков;
//     - включаем питание заново;
//     - переинициализируем AHT20, BMP280, MPU6050;
//     - включаем "тихий" период recovering, чтобы не дёргать их сразу снова.
// ============================================================================
void reinitAllSensors(const char* reason) {
  // Логируем причину, по которой решили перезапустить все датчики
  Serial.print("Reinit ALL sensors (ENV + MPU), reason: ");
  Serial.println(reason);

  // [F16.1] Выключаем ВСЁ питание датчиков одновременным действием
  // ----------------------------------------------------------------
  // Отключаем питание:
  //   - AHT20/BMP280 через AHT_BMP_PWR_PIN (PNP BC327, HIGH = выкл)
  //   - MPU6050       через MPU_PWR_PIN     (PNP BC327, HIGH = выкл)
  // И одновременно гасим светодиоды-индикаторы питания.
  digitalWrite(AHT_BMP_PWR_PIN, HIGH);    // OFF AHT/BMP (отключаем 3.3V)
  digitalWrite(MPU_PWR_PIN,     HIGH);    // OFF MPU   (отключаем 5V)
  digitalWrite(SV1_INDIC_PWR_PIN, LOW);   // LED ENV OFF
  digitalWrite(SV2_MPU_INDIC_PIN, LOW);   // LED MPU OFF
  delay(250);                             // даём питанию полностью "упасть"

  // [F16.2] Включаем ВСЁ питание датчиков одновременным действием
  // ----------------------------------------------------------------
  // Включаем питание на тех же линиях и зажигаем LED-индикаторы.
  digitalWrite(AHT_BMP_PWR_PIN, LOW);     // ON AHT/BMP (подаём 3.3V)
  digitalWrite(MPU_PWR_PIN,     LOW);     // ON MPU    (подаём 5V)
  digitalWrite(SV1_INDIC_PWR_PIN, HIGH);  // LED ENV ON
  digitalWrite(SV2_MPU_INDIC_PIN, HIGH);  // LED MPU ON
  delay(300);                             // даём датчикам время включиться

  // [F16.3] Инициализация ENV (AHT20 + BMP280)
  // ----------------------------------------------------------------
  Serial.println("Reinit ALL: calling aht.begin() / bmp.begin()");

  // Пытаемся снова запустить AHT20
  bool aht_ok_new = aht.begin();
  aht_ok = aht_ok_new;          // обновляем глобальный флаг состояния AHT
  if (!aht_ok_new) ahtErrCount++; // если опять не удалось – увеличиваем "память ошибок" AHT

  // Пытаемся снова запустить BMP280 по адресам 0x76 или 0x77
  bool bmp_ok_new = (bmp.begin(0x76) || bmp.begin(0x77));
  bmp_ok = bmp_ok_new;          // обновляем глобальный флаг состояния BMP
  if (!bmp_ok_new) bmpErrCount++; // если не удалось – увеличиваем "память ошибок" BMP

  // Логируем результат перезапуска ENV
  Serial.print("Reinit ALL: AHT=");
  Serial.print(aht_ok_new ? "OK" : "ERR");
  Serial.print(" BMP=");
  Serial.println(bmp_ok_new ? "OK" : "ERR");

  // [F16.4] Инициализация MPU6050
  // ----------------------------------------------------------------
  Serial.println("Reinit ALL: calling initMPU()");
  bool mpu_ok_new = initMPU();  // полная инициализация/калибровка MPU
  mpu_ok    = mpu_ok_new;       // глобальный флаг состояния MPU
  mpu_error = !mpu_ok_new;      // фиксируем последнюю ошибку

  Serial.print("Reinit ALL: MPU=");
  Serial.println(mpu_ok_new ? "OK" : "ERR");

  // [F16.5] Служебные флаги и «тихий» период после reinit
  // ----------------------------------------------------------------
  // Обнуляем текущую серию ошибок чтения MPU.
  mpuReadErrorStreak = 0;

  // Включаем режим recovering, чтобы немного "подождать" после реинициализации:
  //   - recovering = true     -> ENV/MPU в некоторых местах не опрашиваются;
  //   - recoverUntilMs        -> время, когда "тихий" период закончится.
  recovering = true;
  recoverUntilMs = millis() + RECOVER_MS;  // RECOVER_MS обычно 2000 мс (2 секунды)
}

// ============================================================================
//   [F16.6] manualZeroReset – ручной сброс нуля горизонта и курса
//   Вызывается при длинном нажатии кнопки в HUD-режиме, когда MPU в строю.
//   Логика:
//     - считаем текущую ориентацию по сглаженному акселерометру;
//     - принимаем её за "новый ноль" горизонта;
//     - обнуляем виртуальный курс относительно этого горизонта;
//     - обновляем флаги horizonZeroSet / headingZeroSet.
// ============================================================================
void manualZeroReset() {
  // Используем текущие сглаженные ax_f/ay_f/az_f для вычисления "сырых" углов
  // по тем же формулам, что в [F18.2.3].
  float roll_rad  = atan2(ay_f, az_f);
  float pitch_rad = atan2(-ax_f, sqrt(ay_f * ay_f + az_f * az_f));

  // Переводим в градусы
  float roll_raw_deg  = roll_rad  * 180.0f / PI;
  float pitch_raw_deg = pitch_rad * 180.0f / PI;

  // Ставим текущее "физическое" положение как новый ноль горизонта:
  //   - roll_zero_deg/pitch_zero_deg теперь соответствуют тому, как
  //     плата была ориентирована в момент длинного нажатия.
  roll_zero_deg  = roll_raw_deg;
  pitch_zero_deg = pitch_raw_deg;
  horizonZeroSet = true;   // помечаем, что ноль горизонта определён

  // Приводим текущие углы к нулю относительно нового нуля (по идее ~0/0)
  roll_deg  = roll_raw_deg  - roll_zero_deg;
  pitch_deg = pitch_raw_deg - pitch_zero_deg;

  // Сбрасываем виртуальный курс относительно нового нуля горизонта:
  //   - текущий heading_deg = 0;
  //   - last_roll_for_heading = текущий крен (около 0);
  //   - headingInitDone/headingZeroSet = true.
  heading_deg           = 0.0f;
  last_roll_for_heading = roll_deg;
  headingInitDone       = true;
  headingZeroSet        = true;

  // Логируем новый ноль горизонта
  Serial.println("MANUAL ZERO RESET:");
  Serial.print("  roll_zero_deg=");
  Serial.print(roll_zero_deg, 1);
  Serial.print("  pitch_zero_deg=");
  Serial.println(pitch_zero_deg, 1);

  // Краткое сообщение на TFT о том, что ноль был сброшен
  tft.fillScreen(COL_FON1);
  tft.setTextWrap(false);
  tft.setTextColor(ST77XX_YELLOW, COL_FON1);
  tft.setTextSize(1);
  tft.setCursor(10, tft.height() / 2 - 10);
  tft.print("ZERO RESET");
  tft.setCursor(10, tft.height() / 2);
  tft.print("HORIZON & HDG");
  delay(800);   // короткая пауза, чтобы успеть прочитать надпись

  // После сообщения восстанавливаем текущий экранный фрейм:
  //   - если сейчас METEO -> перерисовать каркас METEO;
  //   - если HUD         -> перерисовать каркас HUD.
  // lastScreenUpdate = 0, чтобы форсировать немедленное обновление.
  if (displayMode == 0) {
    drawEnvFrame();
    lastScreenUpdate = 0;
  } else {
    drawMPUFrame();
    lastScreenUpdate = 0;
  }
}

// ============================================================================
//   [F17] setup – инициализация устройств
// ============================================================================
void setup() {
  // Поднимаем Serial для отладки
  Serial.begin(115200);
  while (!Serial) {         // ждём готовности USB-Serial (актуально для UNO R4)
    delay(10);
  }

  Serial.println("=== SETUP START ===");

  // Инициализация I2C-шины (общая шина для AHT20, BMP280, MPU6050)
  Wire.begin();
  Wire.setClock(100000);    // 100 кГц – надёжная скорость

  // Настройка пинов ввода/вывода
  pinMode(buttonPin,         INPUT_PULLUP); // кнопка: внутр. подтяжка к Vcc
  pinMode(AHT_BMP_PWR_PIN,   OUTPUT);       // питание AHT/BMP
  pinMode(SV1_INDIC_PWR_PIN, OUTPUT);       // LED AHT/BMP
  pinMode(MPU_PWR_PIN,       OUTPUT);       // питание MPU6050
  pinMode(SV2_MPU_INDIC_PIN, OUTPUT);       // LED MPU

  // [F17.1] Питание AHT/BMP (3.3V через BC327)
  // Сначала гарантированно выключаем питание, затем включаем: "холодный" старт.
  digitalWrite(AHT_BMP_PWR_PIN, HIGH);   // HIGH = выкл питания AHT/BMP
  digitalWrite(SV1_INDIC_PWR_PIN, LOW);  // LED AHT/BMP выкл
  delay(50);

  digitalWrite(AHT_BMP_PWR_PIN, LOW);    // LOW = вкл питания AHT/BMP
  digitalWrite(SV1_INDIC_PWR_PIN, HIGH); // LED AHT/BMP вкл
  delay(100);                            // ждём стабилизации

  // [F17.2] Питание MPU6050 (5V через BC327)
  digitalWrite(MPU_PWR_PIN, HIGH);       // пока выключено питание MPU
  digitalWrite(SV2_MPU_INDIC_PIN, LOW);  // LED MPU выкл
  delay(50);

  digitalWrite(MPU_PWR_PIN, LOW);        // включаем 5V на MPU6050
  digitalWrite(SV2_MPU_INDIC_PIN, HIGH); // LED MPU вкл
  delay(300);                            // даём MPU "проснуться"

  // [F17.3] Инициализация TFT
  tft.initR(INITR_BLACKTAB);             // базовая инициализация ST7735
  tft.setRotation(SET_ROTAC);            // поворот экрана
  tft.fillScreen(COL_FON1);              // заливаем фон (фиолетовый)
  tft.setTextWrap(false);                // не переносить текст автоматически

  // Сообщение "INIT SENS" на время инициализации датчиков ENV/MPU
  showMessageTFT("INIT SENS", ZAGOLOVOK, COL_TEXT1, COL_FON1);
  delay(500);

  // [F17.4] Инициализация AHT20
  if (!aht.begin()) {
    // AHT20 не ответил
    aht_ok = false;
    Serial.println("AHT20 not found");
    showMessageTFT("AHT20 ERR", ZAGOLOVOK, COL_TEXT4, COL_FON4);
    delay(500);

    // Увеличиваем "память ошибок" AHT20:
    //   ahtErrCount – это накопительный счётчик, который НЕ обнуляется
    //   при reinitAllSensors(). По нему можно понять, сколько раз за всё
    //   время работы AHT20 не инициализировался или перестал отвечать.
    ahtErrCount++;

    // Фиксируем общую потерю связи по ENV-части:
    //   poterya_svyazi = true означает, что хотя бы один из ENV-датчиков
    //   (AHT20 или BMP280) при старте не вышел в рабочий режим.
    //   Этот флаг можно использовать дальше для принятия решений
    //   об автоматическом восстановлении, логике "ожидания" и т.п.
    poterya_svyazi = true;

    // Запоминаем момент, когда произошла эта ошибка AHT20:
    //   lastAhtRetry является "опорной точкой" для таймеров повторной
    //   попытки инициализации (AHT_RETRY_INTERVAL). Это позволяет
    //   не дёргать датчик постоянно, а подождать разумную паузу.
    lastAhtRetry   = millis();
  } else {
    aht_ok = true;
    Serial.println("AHT20 OK");
    showMessageTFT("AHT20 OK", ZAGOLOVOK, COL_TEXT5, COL_FON5);
    delay(500);
  }

  // [F17.5] Инициализация BMP280
  if (!bmp.begin(0x76) && !bmp.begin(0x77)) {
    // ни по 0x76, ни по 0x77 BMP280 не найден
    bmp_ok = false;
    Serial.println("BMP280 not found");
    showMessageTFT("BMP280 ERR", ZAGOLOVOK, COL_TEXT6, COL_FON6);
    delay(500);

     // Увеличиваем "память ошибок" BMP280:
    //   bmpErrCount – накопительный счётчик всех случаев, когда BMP280
    //   не нашёлся на шине или не инициализировался. Аналогично AHT,
    //   этот счётчик помогает оценить надёжность датчика за всё время работы.
    bmpErrCount++;

    // Если до этого ещё не было зафиксировано, что ENV "отвалился"...
    if (!poterya_svyazi) {
      // ...то ставим общий флаг потери связи по ENV.
      //   Сейчас причиной стал именно BMP280, но логика выше смотрит
      //   только на сам факт, что "что-то из ENV работает нестабильно".
      poterya_svyazi = true;

      // И также обновляем lastAhtRetry (общая "опорная метка" времени
      // для повторных попыток восстановления ENV-части).
      // Название переменной историческое, используется и для AHT, и для BMP.
      lastAhtRetry   = millis();
    }
  } else {
    bmp_ok = true;
    Serial.println("BMP280 OK");
    showMessageTFT("BMP280 OK", ZAGOLOVOK, COL_TEXT7, COL_FON7);
    delay(500);

    // Настраиваем режим работы BMP280.
    // setSampling() управляет тем, КАК датчик будет измерять давление/температуру:
    //
    //   1) Режим работы (MODE_NORMAL):
    //        - BMP280 сам циклически делает измерения
    //        - между измерениями делает "стойку" (STANDBY)
    //
    //   2) Oversampling (SAMPLING_X2 / SAMPLING_X16):
    //        - сколько внутренних измерений усредняются для одного результата;
    //        - чем выше множитель, тем меньше шум, но дольше измерение.
    //
    //   3) Фильтр (FILTER_X16):
    //        - встроенный цифровой фильтр BMP280, сглаживает быстрые колебания;
    //        - помогает убрать дрожание высоты от шума давления.
    //
    //   4) Standby (STANDBY_MS_500):
    //        - пауза между циклами измерений в режиме MODE_NORMAL;
    //        - влияет на частоту обновления внутренних данных датчика.
    //
    // В нашем случае настройки такие:
    //   MODE_NORMAL      – постоянные измерения без ручного "просыпания";
    //   SAMPLING_X2 T    – небольшой oversampling по температуре
    //                       (температура нам нужна скорее как фон, а не эталон);
    //   SAMPLING_X16 P   – сильное усреднение давления, чтобы высота была
    //                       максимально стабильной, пусть даже чуть "ленивой";
    //   FILTER_X16       – максимальный встроенный фильтр BMP280, ещё одно
    //                       сглаживание поверх oversampling'а;
    //   STANDBY_MS_500   – внутри BMP280 новое измерение раз в ~0.5 секунды,
    //                       этого достаточно для медленных баро-изменений.
    bmp.setSampling(
      Adafruit_BMP280::MODE_NORMAL,   // режим непрерывных измерений
      Adafruit_BMP280::SAMPLING_X2,  // oversampling температуры: 2x
      Adafruit_BMP280::SAMPLING_X16, // oversampling давления: 16x
      Adafruit_BMP280::FILTER_X16,   // максимальный цифровой фильтр
      Adafruit_BMP280::STANDBY_MS_500 // пауза между циклами ~500 мс
    );

    // [F17.5.1] Калибровка высоты: принимаем текущую точку как "0 м".
    //
    //   Идея:
    //     - BMP280 выдаёт абсолютную высоту относительно уровня моря
    //       при заданном опорном давлении SEA_LEVEL_HPA.
    //     - Нас интересует относительная высота (на сколько мы поднялись/опустились
    //       относительно МЕСТА УСТАНОВКИ прибора), а не истинный уровень над морем.
    //     - Поэтому при включении мы многократно считываем высоту и усредняем её:
    //       это будет наша "нулевая" высота altitudeOffset_m.
    //
    //   Почему несколько измерений:
    //     - одно измерение может быть зашумлено (микроколебания давления);
    //     - усреднение 20 раз даёт более стабильное начальное значение.
    //
    const int ALT_CAL_SAMPLES = 20;  // сколько раз считываем высоту для усреднения
    float sumAlt = 0.0f;             // сумма всех измерений высоты

    for (int i = 0; i < ALT_CAL_SAMPLES; i++) {
      // bmp.readAltitude(SEA_LEVEL_HPA) возвращает абсолютную высоту (в метрах)
      // исходя из текущего давления и заданного уровня моря SEA_LEVEL_HPA.
      float altSample = bmp.readAltitude(SEA_LEVEL_HPA);
      sumAlt += altSample;
      delay(50);  // небольшая пауза между измерениями, чтобы датчик успел обновиться
    }

    float a0 = sumAlt / ALT_CAL_SAMPLES;  // средняя высота по месту установки
    altitudeOffset_m = a0;                // запоминаем как "0 м"
    altitude_m       = 0.0f;              // относительная высота = 0
    altitude_m_f     = 0.0f;              // и сглаженная тоже

    // Для контроля выводим в Serial калиброванное "нулевое" значение высоты:
    //   Alt0 (calibrated avg) = <a0>
    // где a0 – средняя абсолютная высота (в метрах) по 20 измерениям.
    // Ниже мы принимаем её за 0 м для всех дальнейших относительных высот.
    Serial.print("Alt0 (calibrated avg) = ");
    Serial.println(a0);      // в метрах, от bmp.readAltitude(SEA_LEVEL_HPA)
  }

  // [F17.6] Инициализация MPU6050 через initMPU (после ENV)
  Serial.println("=== MPU init from setup (after ENV) ===");
  bool mpu_init_ok = initMPU();           // initMPU сам калибрует и фиксирует ноль горизонта/курса
  Serial.print("MPU init in setup = ");
  Serial.println(mpu_init_ok ? "OK" : "ERR");

  if (mpu_init_ok) {
    showMessageTFT("MPU OK", ZAGOLOVOK, COL_TEXT2, COL_FON2);
  } else {
    showMessageTFT("MPU ERR", ZAGOLOVOK, COL_TEXT3, COL_FON3);
  }
  delay(500);

  // Стартуем в METEO-режиме
  displayMode = 0;
  drawEnvFrame();                         // рисуем каркас METEO-экрана (подписи)

  unsigned long now = millis();
  lastScreenUpdate = now;                 // время последнего обновления экрана
  lastSerialPrint  = now;                 // время последнего METEO-лога в Serial
  startTime        = now;                 // для логики стабилизации высоты

  // Запускаем CBTimer на 1 Гц – для миганий и прочих периодических задач
  uiTimer.begin(1000, uiTimerCallback, true);

   // Стартовый лог по высоте и скорости I2C.
  // ALT_zero:
  //   - если altZeroRefSet == true, значит ноль высоты уже был захвачен
  //     ранее (в процессе работы, после периода стабилизации) – выводим altZeroRef;
  //   - если altZeroRefSet == false (обычно сразу после включения),
  //     то в качестве "нуля" используем altitudeOffset_m (усреднённую высоту при старте).
  //
  // ALT_offset_m:
  //   - базовая "нулевая" высота по месту установки, полученная при калибровке
  //     BMP280 в setup() (среднее из ALT_CAL_SAMPLES измерений).
  //
  // I2C_speed:
  //   - текущая частота шины I2C (мы выше задали 100000 Гц).
  Serial.print("START: ALT_zero=");
  Serial.print(altZeroRefSet ? altZeroRef : altitudeOffset_m, 2);
  Serial.print("  ALT_offset_m=");
  Serial.print(altitudeOffset_m, 2);
  Serial.print("  I2C_speed=");
  Serial.print(100000);
  Serial.println("Hz");

  Serial.println("=== SETUP DONE ===");
}

// ============================================================================
//   [F18] loop – основной цикл
//   Структура:
//     1) Обработка "тихого" периода после reinitAllSensors() (recovering)
//     2) В HUD-режиме: чтение MPU, расчёт крена/тангажа/курса, обработка ошибок MPU
//     3) В METEO/HUD: чтение ENV (AHT/BMP) с разной частотой
//     4) Расчёт тренда давления (METEO)
//     5) Обработка кнопки (короткое / длинное нажатие)
//     6) Периодические логи (ENV+MPU / высота)
//     7) Обновление экрана (METEO/HUD)
// ============================================================================
void loop() {
  // Текущее время в миллисекундах – общий "таймер" цикла
  unsigned long now = millis();

  // --------------------------------------------------------------------------
  // [F18.1] Режим восстановления после общего сброса датчиков
  // --------------------------------------------------------------------------
  // После вызова reinitAllSensors() выставляем:
  //   recovering     = true;
  //   recoverUntilMs = millis() + RECOVER_MS;
  //
  // В этом блоке ждём, пока закончится "тихий" период, чтобы не перезапускать
  // датчики слишком часто и дать им стабилизироваться.
  if (recovering && (long)(recoverUntilMs - now) <= 0) {
    recovering = false;                   // "тихий" период закончился
    Serial.println("RECOVER window finished");
  }

  // --------------------------------------------------------------------------
  // [F18.2] ЧТЕНИЕ MPU + обработка ошибок (только в HUD-режиме)
  // --------------------------------------------------------------------------
  // MPU читаем, только когда активен HUD (displayMode == 1).
  // METEO-экран не требует ориентации/курса, поэтому MPU там не дёргаем.
  if (displayMode == 1) {

    // Если MPU уже в состоянии ошибки (mpu_ok == false) – пытаемся его
    // поднять через общий reinitAllSensors(), но не чаще заданного интервала.
    if (!mpu_ok) {
      unsigned long now2 = millis();                      // текущее время для MPU-ретрая
      const unsigned long MPU_RETRY_INTERVAL_LOCAL = 5000; // минимум 5 секунд между попытками

      if (now2 - lastMpuRetry > MPU_RETRY_INTERVAL_LOCAL) {
        // Давно не пытались – запускаем общий сброс всех датчиков
        lastMpuRetry = now2;
        Serial.println("MPU in ERR state on HUD -> reinitAllSensors()");
        reinitAllSensors("MPU in ERR on HUD");
      }
    } else {
      // ----------------------------------------------------------------------
      // [F18.2.2] mpu_ok == true: нормальное чтение + отслеживание ошибок
      // ----------------------------------------------------------------------

      // Буфер на 14 байт для блока данных MPU:
      //   аксель (6 байт) + температура (2) + гиро (6)
      uint8_t data[14];

      // Пытаемся прочитать с MPU 14 байт, начиная с регистра 0x3B
      uint8_t readCount = mpuRead(0x3B, data, 14);

      // Если прочитали меньше 14 байт – ошибка чтения или сбой по I2C
      if (readCount < 14) {
        unsigned long now2 = millis();             // время ошибки
        unsigned long dt   = now2 - mpuLastInitTime; // сколько прошло с последнего initMPU()
        // diffBmp – время (мс) с момента последнего успешного чтения BMP280(может помочь в диагностике)
        // -1 означает, что BMP ещё ни разу не читали (lastBmpReadMs == 0).
        long diffBmp       = (lastBmpReadMs == 0) ? -1 : (long)now2 - (long)lastBmpReadMs;

        // Логируем факт "укороченного" чтения MPU:
        //   - now2          : текущее время, когда произошла ошибка чтения;
        //   - dt            : сколько миллисекунд прошло с последнего initMPU();
        //   - displayMode   : в каком режиме (METEO/HUD) мы были на момент ошибки;
        //   - diffBmp       : через сколько миллисекунд после последнего чтения BMP280
        //                     произошла эта ошибка (или -1, если BMP ещё не читали).
        Serial.print("MPU short read at ms=");
        Serial.print(now2);           // текущее время ошибки чтения MPU
        Serial.print(" dt since init=");
        Serial.print(dt);            // время с последнего initMPU()
        Serial.print("ms  displayMode=");
        Serial.print(displayMode);   // 0 = METEO, 1 = HUD
        Serial.print("  diffToLastBMP=");
        Serial.print(diffBmp);       // мс с момента последнего чтения BMP или -1
        Serial.println("ms");

         // Дополнительно выводим последнее известное состояние MPU на момент ошибки:
        //   - roll_deg, pitch_deg : "логические" крен и тангаж (уже с учётом нуля горизонта);
        //   - ax_last..az_last    : последние сглаженные значения акселерометра по осям X/Y/Z;
        //   - gx_last..gz_last    : последние сглаженные значения гироскопа (угл. скорость);
        //   - temp_last           : последняя измеренная температура MPU.
        //
        // По этому блоку в логе можно понять:
        //   * был ли в момент ошибки заметный крен/тангаж;
        //   * было ли движение по акселерометру / гироскопу;
        //   * какая была температура датчика (не перегрелся ли).
        Serial.print("MPU state at error: roll=");
        Serial.print(roll_deg, 1);   // крен (градусы, уже относительно нуля горизонта)
        Serial.print(" pitch=");
        Serial.print(pitch_deg, 1);  // тангаж (градусы, относительно нуля горизонта)

        Serial.print("  ax=");
        Serial.print(ax_last, 2);    // аксель X (g), сглаженное значение
        Serial.print(" ay=");
        Serial.print(ay_last, 2);    // аксель Y (g)
        Serial.print(" az=");
        Serial.print(az_last, 2);    // аксель Z (g), в покое ≈ +1 g

        Serial.print("  gx=");
        Serial.print(gx_last, 1);    // гироскоп X (deg/s), сглаженное значение
        Serial.print(" gy=");
        Serial.print(gy_last, 1);    // гироскоп Y (deg/s)
        Serial.print(" gz=");
        Serial.print(gz_last, 1);    // гироскоп Z (deg/s)

        Serial.print("  temp=");
        Serial.print(temp_last, 1);  // температура MPU (°C)
        Serial.println("C");

        // Оценка: "стояли" мы или "двигались" при ошибке MPU.
        // ---------------------------------------------------
        // Идея:
        //   - Если сбои чтения происходят ТОЛЬКО тогда, когда всё стоит неподвижно,
        //     это похоже на проблему "железа" (контакт, пайка, шум по питанию).
        //   - Если сбои появляются ТОЛЬКО при движении, возможно, просадки питания
        //     именно при нагрузке или плохая помехоустойчивость.
        //
        // Поэтому на основе последнего состояния акселя/гиро мы грубо решаем:
        //   "стояли" (still) или "двигались" (moving) в момент ошибки.

        // Условия "покоя" по акселерометру и гироскопу:
        //   ACC_STILL_THRESH  – допустимое отклонение по акселю от идеала;
        //                       в покое: ax≈0, ay≈0, az≈1 g.
        //   GYRO_STILL_THRESH – допустимая угловая скорость в deg/s;
        //                       в покое: gx≈0, gy≈0, gz≈0.
        const float ACC_STILL_THRESH  = 0.05f;  // если модуль отклонения > 0.05 g – считаем, что аксель "шевелится"
        const float GYRO_STILL_THRESH = 5.0f;   // если скорость вращения > 5 deg/s – считаем, что "крутимся"

        // accMoving: хотя бы по одной оси акселерометра вылезли за пределы "тихого" порога.
        //   - по X/Y: просто берём |ax| и |ay|;
        //   - по Z: сравниваем |az - 1.0|, т.к. в покое Z ≈ +1 g (гравитация).
        bool accMoving  = (fabs(ax_last) > ACC_STILL_THRESH) ||
                          (fabs(ay_last) > ACC_STILL_THRESH) ||
                          (fabs(az_last - 1.0f) > ACC_STILL_THRESH);

        // gyroMoving: гироскоп показывает заметное вращение по хотя бы одной оси.
        bool gyroMoving = (fabs(gx_last) > GYRO_STILL_THRESH) ||
                          (fabs(gy_last) > GYRO_STILL_THRESH) ||
                          (fabs(gz_last) > GYRO_STILL_THRESH);

        // Итог: движемся ли сейчас (по любому из датчиков).
        // Если хоть аксель, хоть гироскоп говорят "движемся" – считаем, что движение есть.
        bool movingNow = accMoving || gyroMoving;

        // Статистика ошибок:
        //   - mpuErrWhileStill  – сколько раз ошибка чтения MPU случалась, когда "стояли";
        //   - mpuErrWhileMoving – сколько раз ошибка чтения MPU случалась, когда "двигались".
        // Это помогает понять характер отказов MCU/MPU "по жизни".
        if (movingNow) mpuErrWhileMoving++;
        else           mpuErrWhileStill++;

        // Лог по статистике ошибок на момент текущего сбоя.
        Serial.print("MPU_ERR_STATS: movingNow=");
        Serial.print(movingNow ? "YES" : "NO");  // YES – была динамика, NO – стояли
        Serial.print("  errStill=");
        Serial.print(mpuErrWhileStill);          // всего ошибок "на месте"
        Serial.print("  errMove=");
        Serial.println(mpuErrWhileMoving);       // всего ошибок "в движении"

        // Если ошибка произошла слишком вскоре после initMPU() – игнорируем её,
        // т.к. MPU ещё может не успеть "устаканиться".
        if (dt < MPU_GRACE_MS) {
          Serial.println("MPU read error in grace period, ignored");
        } else {
          // Вышли из "льготного" периода – считаем это полноценной ошибкой чтения
          mpuReadErrorStreak++;   // увеличиваем серию подряд идущих ошибок
          Serial.print("MPU read error (");
          Serial.print(mpuReadErrorStreak);
          Serial.println(")");

          // Если таких ошибок подряд набралось достаточно – инициируем общий сброс датчиков
          if (mpuReadErrorStreak >= 5) {
            unsigned long now2b = millis();
            mpuErrCount++;              // запоминаем ошибку в "памяти MPU"
            mpuReadErrorStreak = 0;     // сбрасываем текущую серию

            // Локальный интервал для повторной попытки восстановления MPU:
            //   MPU_RETRY_INTERVAL_LOCAL = 5000 мс (5 секунд).
            // Идея:
            //   - если мы уже недавно делали reinitAllSensors(), нет смысла
            //     сразу же снова выключать/включать питание датчиков;
            //   - даём системе "подышать" хотя бы 5 секунд перед следующей
            //     серьёзной попыткой восстановления.
            const unsigned long MPU_RETRY_INTERVAL_LOCAL = 5000; // чтобы не дёргать слишком часто

            // Проверяем, прошло ли достаточно времени с последнего reinit по MPU
            if (now2b - lastMpuRetry > MPU_RETRY_INTERVAL_LOCAL) {
              // Прошло больше 5 секунд – можно снова попытаться перезапустить все датчики
              lastMpuRetry = now2b;  // запоминаем время этой попытки

              Serial.println("MPU read error streak -> reinitAllSensors()");
              reinitAllSensors("MPU read errors streak");  // полный сброс ENV + MPU
            } else {
              // Если с последнего reinit прошло меньше 5 секунд – пропускаем,
              // только логируем факт, что серия ошибок есть, но сброс "заглушен".
              Serial.println("MPU read error streak, reinitAllSensors() suppressed (too frequent)");
            }
          }
        }

      } else {
         // --------------------------------------------------------------------
        // [F18.2.3] Успешное чтение MPU – считаем ориентацию и виртуальный курс
        // --------------------------------------------------------------------
        // Так как чтение было полным (14 байт), серия ошибок обнуляется:
        mpuReadErrorStreak = 0;   // предыдущие ошибки "забываем" до следующего сбоя

        // Распаковываем "сырые" 16-битные значения из буфера data.
        // Формат блока данных MPU6050 (начиная с регистра 0x3B):
        //   0,1 : ACCEL_XOUT_H/L
        //   2,3 : ACCEL_YOUT_H/L
        //   4,5 : ACCEL_ZOUT_H/L
        //   6,7 : TEMP_OUT_H/L
        //   8,9 : GYRO_XOUT_H/L
        //  10,11: GYRO_YOUT_H/L
        //  12,13: GYRO_ZOUT_H/L
        int16_t ax_raw  = (int16_t)(data[0] << 8 | data[1]);   // "сырой" аксель X
        int16_t ay_raw  = (int16_t)(data[2] << 8 | data[3]);   // "сырой" аксель Y
        int16_t az_raw  = (int16_t)(data[4] << 8 | data[5]);   // "сырой" аксель Z
        int16_t tempRaw = (int16_t)(data[6] << 8 | data[7]);   // "сырая" температура
        int16_t gx_raw  = (int16_t)(data[8] << 8 | data[9]);   // "сырой" гироскоп X
        int16_t gy_raw  = (int16_t)(data[10] << 8 | data[11]); // "сырой" гироскоп Y
        int16_t gz_raw  = (int16_t)(data[12] << 8 | data[13]); // "сырой" гироскоп Z

        // Применяем ранее вычисленные оффсеты и масштабы.
        // Эти оффсеты (ax_offset, gx_offset и т.п.) заполняются в calibrateMPU().
        //
        // Акселерометр:
        //   - в режиме ±2g чувствительность ≈ 16384 LSB/g,
        //   - поэтому (raw - offset) / 16384.0f даёт ускорение в "g".
        float ax = (ax_raw - ax_offset) / 16384.0f;  // ускорение по X, g
        float ay = (ay_raw - ay_offset) / 16384.0f;  // ускорение по Y, g
        float az = (az_raw - az_offset) / 16384.0f;  // ускорение по Z, g

        // Гироскоп:
        //   - в режиме ±250 dps чувствительность ≈ 131 LSB/(deg/s),
        //   - поэтому (raw - offset) / 131.0f даёт скорость вращения в deg/s.
        float gx = (gx_raw - gx_offset) / 131.0f;    // угловая скорость по X, deg/s
        float gy = (gy_raw - gy_offset) / 131.0f;    // по Y, deg/s
        float gz = (gz_raw - gz_offset) / 131.0f;    // по Z, deg/s

        // Температура:
        // по даташиту: Temp(C) = raw/340 + 36.53 + temp_offset.
        // сейчас temp_offset = 0.0f; если ты заметим, что реальная температура MPU 
        // (померенная внешним термометром) стабильно отличается, например, на +2 °C, 
        // то можно задать: temp_offset = -2.0f; 
        // и тем самым «подкрутить» показания, не трогая саму формулу.
        float tempC = (tempRaw / 340.0f) + 36.53f + temp_offset;

        // Сохраняем последние "сырые-нормированные" значения для логов и диагностики.
        // Эти переменные используются при логировании ошибки (см. блок "MPU state at error").
        ax_last   = ax;  ay_last   = ay;  az_last   = az;
        gx_last   = gx;  gy_last   = gy;  gz_last   = gz;
        temp_last = tempC;

        // Применяем экспоненциальное сглаживание alpha ко всем каналам MPU.
        // Идея:
        //   - снижать шум и дрожание в показаниях;
        //   - сделать HUD (горизонт, курс) более плавным.
        //
        // Формула: x_f = x_f + alpha * (x - x_f);
        //   alpha ~ 0.1 означает "90% прошлого, 10% нового" – достаточно плавно.
        ax_f   = ax_f   + alpha * (ax   - ax_f);
        ay_f   = ay_f   + alpha * (ay   - ay_f);
        az_f   = az_f   + alpha * (az   - az_f);
        gx_f   = gx_f   + alpha * (gx   - gx_f);
        gy_f   = gy_f   + alpha * (gy   - gy_f);
        gz_f   = gz_f   + alpha * (gz   - gz_f);
        temp_f = temp_f + alpha * (tempC - temp_f);

        // На основе сглаженных значений акселерометра вычисляем углы крена и тангажа.
        //
        // Крен (roll):  atan2(ay, az)
        //   - если наклонять плату вокруг оси X (крен), меняется соотношение ay/az.
        //
        // Тангаж (pitch): atan2(-ax, sqrt(ay^2 + az^2))
        //   - берём -ax, чтобы сохранялось привычное направление "нос вверх/вниз".
        float roll_rad_calc  = atan2(ay_f, az_f);                             // в радианах
        float pitch_rad_calc = atan2(-ax_f, sqrt(ay_f * ay_f + az_f * az_f)); // в радианах

        // Переводим углы из радиан в градусы
        float roll_raw_deg  = roll_rad_calc  * 180.0f / PI;
        float pitch_raw_deg = pitch_rad_calc * 180.0f / PI;

        // Применяем нули горизонта, сохранённые в:
        //   roll_zero_deg, pitch_zero_deg
        // Эти нули фиксируются:
        //   - при первом успешном initMPU();
        //   - либо при ручном сбросе нуля (manualZeroReset()).
        //
        // Если ноль горизонта уже известен (horizonZeroSet == true),
        // считаем roll_deg/pitch_deg как отклонение от этого нуля.
        if (horizonZeroSet) {
          roll_deg  = roll_raw_deg  - roll_zero_deg;   // крен относительно запомненного горизонта
          pitch_deg = pitch_raw_deg - pitch_zero_deg;  // тангаж относительно запомненного горизонта
        } else {
          // Если ноль горизонта ещё не зафиксирован – используем "сырые" углы.
          roll_deg  = roll_raw_deg;
          pitch_deg = pitch_raw_deg;
        }

        // Дополнительный фильтр по крену для расчёта виртуального курса.
        // --------------------------------------------------------------
        // roll_for_heading_deg – "более плавная" версия roll_deg,
        // которая используется ТОЛЬКО для интеграла курса (heading_deg).
        //
        // Причина:
        //   - мелкий шум по крену вызывает дрожание виртуального курса
        //     (так как мы интегрируем dRoll);
        //   - отдельный сглаженный канал позволяет сделать курс более "спокойным",
        //     не мешая быстрому отклику самого горизонта (roll_deg).
        roll_for_heading_deg =
          roll_for_heading_deg + HEADING_ROLL_ALPHA * (roll_deg - roll_for_heading_deg);

        // --------------------------------------------------------------------
        // [F18.2.3.1] Виртуальный курс по интегралу крена (heading_deg)
        // --------------------------------------------------------------------
        // Идея:
        //   - Мы НЕ используем магнитометр, поэтому "курс" берём искусственно:
        //   - интегрируем изменения крена (roll_for_heading_deg) по времени.
        //
        //   Примерно:
        //     - если поворачиваем "самолёт" вправо, крен меняется определённым
        //       образом, и мы трактуем это как разворот по курсу;
        //     - каждое изменение крена dRoll добавляем к heading_deg;
        //     - таким образом получаем "виртуальный курс".
        //
        //   heading_deg:
        //     - хранится в диапазоне 0..360 (с нормализацией);
        //     - ноль курса задаётся один раз:
        //          * при первом успешном initMPU() (см. [F08.7]),
        //          * или при ручном сбросе нуля manualZeroReset().
        if (!headingInitDone) {
          // Если по какой-то причине интегратор курса ещё не инициализирован
          // (обычно это делается в initMPU),
          // то инициализируем его здесь:
          //
          //   - считаем текущий курс равным 0;
          //   - запоминаем текущее значение крена (уже сглаженного roll_for_heading_deg)
          //     как "опорное" для будущих приращений dRoll.
          heading_deg           = 0.0f;                  // курс = 0
          last_roll_for_heading = roll_for_heading_deg;  // запоминаем текущий крен
          headingInitDone       = true;                  // интегратор готов работать
        } else {
          // Основной режим работы: интегрируем изменение крена.
          //
          // dRoll – изменение крена по отношению к предыдущему значению:
          //   dRoll > 0  -> крен вырос (наклон "в одну сторону")
          //   dRoll < 0  -> крен уменьшился (наклон "в другую сторону")
          float dRoll = roll_for_heading_deg - last_roll_for_heading;

          // Коррекция на переход через ±180°:
          // --------------------------------------------------------------
          // При больших поворотах может быть ситуация, когда крен "перескакивает"
          // через +180/-180 (например, было +179°, стало -179°).
          // В таком случае "сырая" разница dRoll ≈ -358°, хотя реальное
          // изменение угла около +2°.
          //
          // Чтобы избежать таких скачков, если dRoll выходит за ±180°, мы
          // компенсируем это добавлением/вычитанием 360°:
          if (dRoll > 180.0f)  dRoll -= 360.0f;
          if (dRoll < -180.0f) dRoll += 360.0f;

          // Теперь dRoll – "короткое" изменение крена, без искусственных скачков.
          // Интегрируем его в виртуальный курс:
          heading_deg += dRoll;

          // Нормализуем курс в диапазон 0..360°:
          //   - если ушли выше 360 -> вычитаем 360 до тех пор, пока не вернёмся
          //     в нужный диапазон;
          //   - если ушли ниже 0   -> добавляем 360.
          while (heading_deg >= 360.0f) heading_deg -= 360.0f;
          while (heading_deg <   0.0f) heading_deg += 360.0f;

          // Запоминаем текущее значение крена как "предыдущее"
          // для следующего шага интегрирования.
          last_roll_for_heading = roll_for_heading_deg;
        }
      }
    }
  }

  // --------------------------------------------------------------------------
  // [F18.3] ЧТЕНИЕ AHT/BMP (ENV) в METEO и HUD
  // --------------------------------------------------------------------------
  // Здесь организуем опрос "погодных" датчиков:
  //
  //   - AHT20: температура и влажность (aht_tC, aht_hR)
  //   - BMP280: давление и барометрическая высота (p_mmHg, altitude_m, altStep_m)
  //
  // Важно:
  //   * В METEO-режиме (displayMode == 0) опрашиваем ENV часто – каждые 500 мс
  //     (SENSOR_POLL_INTERVAL).
  //   * В HUD-режиме (displayMode == 1) опрашиваем ENV реже – раз в 2 секунды
  //     (HUD_SENSOR_POLL_INTERVAL), чтобы не загружать шину и не мешать MPU.
  //
  // Основная "тяжёлая" логика чтения/обработки высоты вынесена в pollEnvOnce().

  // --- METEO-режим ENV (частый опрос) ---
  if (displayMode == 0 && (now - lastSensorPoll >= SENSOR_POLL_INTERVAL)) {
    // Обновляем отметку времени последнего опроса для METEO
    lastSensorPoll = now;

    if (recovering) {
      // Если мы ещё в "тихом" периоде после reinitAllSensors(),
      // датчики ENV не трогаем – даём им стабилизироваться.
      Serial.println("ENV poll skipped: recovering after reinitAllSensors()");
    } else if (!aht_ok || !bmp_ok) {
      // Хотя бы один из ENV-датчиков в ошибке:
      //   - aht_ok == false -> AHT20 не в строю
      //   - bmp_ok == false -> BMP280 не в строю
      //
      // В этом случае пробуем перезапустить ВСЕ датчики (ENV+MPU) через
      // reinitAllSensors(), но не чаще, чем раз в ENV_RETRY_INTERVAL.
      static unsigned long lastEnvReinitTry = 0;
      const unsigned long ENV_RETRY_INTERVAL = 3000; // не чаще 1 раза в 3 секунды

      if (now - lastEnvReinitTry > ENV_RETRY_INTERVAL) {
        // Прошло достаточно времени с последней попытки – пробуем снова
        lastEnvReinitTry = now;
        Serial.println("ENV in ERR state on METEO -> reinitAllSensors()");
        reinitAllSensors("ENV errors on METEO");
      } else {
        // Слишком частые попытки восстановления ENV – текущую пропускаем
        Serial.println("ENV in ERR, but reinitAllSensors() suppressed (too frequent)");
      }

    } else {
      // Оба датчика ENV в порядке (aht_ok && bmp_ok == true) – нормальная работа.
      // Один опрос:
      //   - прочитать текущие T/H с AHT20,
      //   - прочитать давление/высоту с BMP280,
      //   - обновить сглаженную высоту altitude_m_f и "лестницу" altStep_m.
      pollEnvOnce();
    }
  }

  // --- HUD-режим ENV (редкий опрос) ---
  if (displayMode == 1 && (now - lastHudEnvPoll >= HUD_SENSOR_POLL_INTERVAL)) {
    // Обновляем отметку времени последнего опроса для HUD
    lastHudEnvPoll = now;

    if (recovering) {
      // В "тихом" периоде после reinitAllSensors() ENV тоже не трогаем
      Serial.println("ENV poll (HUD) skipped: recovering after reinitAllSensors()");
    } else if (!aht_ok || !bmp_ok) {
      // ENV в ошибке и мы находимся в HUD-режиме.
      // Здесь логика аналогична METEO, но с отдельным таймером и чуть
      // большим интервалом, чтобы не дёргать reinit слишком часто именно из HUD.
      static unsigned long lastEnvReinitTryHud = 0;
      const unsigned long ENV_RETRY_INTERVAL_HUD = 5000; // 1 попытка в 5 секунд

      if (now - lastEnvReinitTryHud > ENV_RETRY_INTERVAL_HUD) {
        // Давно не пытались восстановить ENV из HUD – делаем reinitAllSensors().
        lastEnvReinitTryHud = now;
        Serial.println("ENV in ERR state on HUD -> reinitAllSensors()");
        reinitAllSensors("ENV errors on HUD");
      } else {
        // Попытка восстановления слишком скоро после предыдущей – пропускаем.
        Serial.println("ENV in ERR (HUD), but reinitAllSensors() suppressed (too frequent)");
      }

    } else {
      // Оба ENV-датчика в рабочем состоянии – делаем один опрос в HUD.
      // Это обновит:
      //   - давление/высоту (для altStep_m в окне высоты HUD),
      //   - T/H (хотя они HUD напрямую не нужны, но полезно иметь "свежими").
      pollEnvOnce();
    }
  }
  // --------------------------------------------------------------------------
  // [F18.4] ТЕНДЕНЦИЯ ДАВЛЕНИЯ (METEO)
  // --------------------------------------------------------------------------
  // Здесь мы оцениваем, как меняется атмосферное давление со временем:
  //
  //   - работаем только в METEO-режиме (displayMode == 0), т.к. тренд нужен
  //     именно для "погодного" экрана;
  //   - только когда BMP280 в исправном состоянии (bmp_ok == true);
  //   - раз в TREND_INTERVAL миллисекунд (по умолчанию 10 минут) сравниваем
  //     текущее p_mmHg с опорным p_trend_ref и выбираем состояние:
  //       * T_STATE_RISE   – давление заметно выросло  (diff > +2 мм рт. ст.)
  //       * T_STATE_FALL   – давление заметно упало   (diff < -2 мм рт. ст.)
  //       * T_STATE_STEADY – изменений в пределах ±2 мм рт. ст.
  //
  // Результат сохраняется в global-переменную pressureTrend и отображается
  // на METEO-экране (см. updateEnvValues()).
  if (displayMode == 0 && bmp_ok) {
    // Если ещё ни разу не оценивали тренд (lastTrendTime == 0),
    // просто запоминаем текущее давление как опорное и время.
    if (lastTrendTime == 0) {
      lastTrendTime = now;   // текущий момент становится стартом отсчёта
      p_trend_ref   = p_mmHg; // опорное давление для сравнения в будущем

    } else if (now - lastTrendTime > TREND_INTERVAL) {
      // Прошло больше TREND_INTERVAL (например, 10 минут) с момента последней оценки.
      // Считаем разницу между текущим давлением и опорным:
      float diff = p_mmHg - p_trend_ref;

      // Интерпретируем разницу diff:
      //   diff > +2.0 мм рт. ст.  -> давление заметно растёт
      //   diff < -2.0 мм рт. ст.  -> давление заметно падает
      //   иначе                  -> считаем, что давление "стабильно"
      if (diff > 2.0f)       pressureTrend = T_STATE_RISE;    // растёт
      else if (diff < -2.0f) pressureTrend = T_STATE_FALL;    // падает
      else                   pressureTrend = T_STATE_STEADY;  // примерно постоянное

      // Обновляем опорное давление для следующего интервала:
      p_trend_ref   = p_mmHg;

      // И фиксируем новое время последней оценки тренда
      lastTrendTime = now;
    }
  }

  // --------------------------------------------------------------------------
  // [F18.5] КНОПКА: короткое нажатие – смена экрана,
  //                 длинное нажатие – ручной сброс нуля горизонта/курса
  // --------------------------------------------------------------------------
  // Кнопка подключена к D2 и настроена как INPUT_PULLUP:
  //   - в "покое" (не нажата) на пине лог.1 (HIGH);
  //   - при нажатии пин замыкается на GND -> лог.0 (LOW).
  //
  // Мы обрабатываем:
  //   - фронты (изменения HIGH/LOW) с антидребезгом;
  //   - различаем короткое и длинное нажатие по длительности удержания.
  //
  // Смысл:
  //   - короткое нажатие (< LONG_PRESS_MS) переключает METEO <-> HUD;
  //   - длинное (>= LONG_PRESS_MS) в HUD-режиме при живом MPU
  //     запускает manualZeroReset() – ручной сброс нуля горизонта и курса.
  bool buttonState = digitalRead(buttonPin);  // читаем текущее состояние пина: HIGH/LOW

  // Обработка фронта кнопки с антидребезгом по времени
  // --------------------------------------------------
  // Если состояние изменилось (HIGH->LOW или LOW->HIGH) и с момента последнего
  // изменения прошло больше DEBOUNCE_MS, считаем это "настоящим" фронтом.
  if (buttonState != lastButtonState &&
      (now - lastButtonChange) > DEBOUNCE_MS) {

    // Фиксируем момент изменения и новое состояние
    lastButtonChange = now;
    lastButtonState  = buttonState;

    if (buttonState == LOW) {
      // Кнопка только что НАЖАТА (переход HIGH -> LOW).
      // Считаем, что началось удержание:
      buttonPressed     = true;      // сейчас кнопку держат
      buttonPressStart  = now;       // запоминаем время начала нажатия
      longPressHandled  = false;     // длинное нажатие ещё не отработано

    } else {
      // Кнопка только что ОТПУЩЕНА (переход LOW -> HIGH).
      if (buttonPressed) {
        // Считаем, сколько времени она была зажата:
        unsigned long pressDur = now - buttonPressStart;

        // Условие КОРОТКОГО нажатия:
        //   - длинное нажатие ещё не было обработано (longPressHandled == false)
        //   - длительность удержания меньше LONG_PRESS_MS (например, < 1.5 с)
        if (!longPressHandled && pressDur < LONG_PRESS_MS) {
          // --- КОРОТКОЕ НАЖАТИЕ: переключение экрана METEO <-> HUD ---

          int oldMode = displayMode;          // запоминаем старый режим
          displayMode = (displayMode + 1) % 2; // 0 -> 1 -> 0 циклически

          if (displayMode == 0) {
            // Переход в METEO-режим:
            //   - рисуем каркас METEO (подписи/рамки)
            //   - обнуляем таймер экрана, чтобы сразу обновить значения
            drawEnvFrame();
            lastScreenUpdate = 0;
          } else {
            // Переход в HUD-режим:
            //   - очищаем под HUD (каркас рисуется в drawMPUFrame())
            //   - форсируем ближайший перерис HUD
            drawMPUFrame();
            lastScreenUpdate = 0;
          }

          // Логируем факт переключения режима и полезные параметры
          Serial.print("MODE_SWITCH: ");
          Serial.print(oldMode == 0 ? "METEO" : "HUD");
          Serial.print(" -> ");
          Serial.print(displayMode == 0 ? "METEO" : "HUD");
          Serial.print(" at ms=");
          Serial.print(now);

          // Дополнительно печатаем информацию по высоте (если ноль высоты уже зафиксирован)
          if (bmp_ok && altZeroRefSet) {
            float alt_rel_now = altitude_m_f - altZeroRef;  // относительная высота
            Serial.print("  ALT_rel=");
            Serial.print(alt_rel_now, 2);
            Serial.print("  ALT_f=");
            Serial.print(altitude_m_f, 2);
          }

          // И температуру MPU, если он в рабочем состоянии
          if (mpu_ok) {
            Serial.print("  MPU_T=");
            Serial.print(temp_f, 1);
          }
          Serial.println();
        }
      }

      // Вне зависимости от того, было короткое или длинное – при отпускании
      // считаем, что удержание кнопки завершилось.
      buttonPressed = false;
    }
  }

  // Проверка на ДЛИННОЕ нажатие, пока кнопка удерживается
  // -----------------------------------------------------
  // Здесь мы НЕ ждём отпускания кнопки: как только длительность превысила
  // LONG_PRESS_MS, сразу выполняем "длинное" действие (один раз).
  if (buttonPressed && !longPressHandled) {
    unsigned long pressDur = now - buttonPressStart;

    if (pressDur >= LONG_PRESS_MS) {
      // Считаем длинное нажатие отработанным, чтобы не срабатывало повторно,
      // пока кнопку ещё держат.
      longPressHandled = true;

      // Условие для ручного сброса нуля:
      //   - MPU должен быть в рабочем состоянии (mpu_ok == true),
      //   - режим должен быть HUD (displayMode == 1), т.к. сбрасываем
      //     именно ноль горизонта/курса HUD.
      if (mpu_ok && displayMode == 1) {
        // Ручной "сброс нуля" горизонта и курса (см. manualZeroReset()):
        //   - текущая ориентация -> roll_zero_deg/pitch_zero_deg;
        //   - heading_deg = 0;
        //   - флаги horizonZeroSet/headingZeroSet = true.
        manualZeroReset();
      } else {
        // Если MPU не в порядке или мы не в HUD – сброс нуля не выполняем.
        Serial.println("MANUAL ZERO RESET ignored (MPU not OK or not in HUD mode)");
      }
    }
  }

  // --------------------------------------------------------------------------
  // [F18.6] ПЕРИОДИЧЕСКИЙ ВЫВОД В SERIAL (METEO-режим)
  // --------------------------------------------------------------------------
  // Раз в serialPrintInterval (по умолчанию 60 секунд) печатаем в Serial
  // "сводку" по состоянию MPU и ENV:
  //   - температура MPU;
  //   - температура/влажность/точка росы по AHT20;
  //   - давление и тренд давления по BMP280;
  //   - накопленные счётчики ошибок по каждому датчику.
  //
  // Выводим это ТОЛЬКО в METEO-режиме (displayMode == 0), чтобы не
  // забивать лог, пока работаем в HUD.
  if (displayMode == 0 && now - lastSerialPrint > serialPrintInterval) {
    // Обновляем момент последнего вывода
    lastSerialPrint = now;

    // --- Блок по MPU ---
    Serial.print("MPU: ");
    if (mpu_ok) {
      // Если MPU в рабочем состоянии – выводим его температуру
      Serial.print("T="); Serial.print(temp_f, 1); Serial.print("C  ");
    } else {
      // Если MPU сейчас в ошибке – просто помечаем "ERR"
      Serial.print("ERR  ");
    }

    // --- Блок по ENV (AHT20) ---
    Serial.print("ENV: ");
    if (aht_ok) {
      // Температура воздуха
      Serial.print("T="); Serial.print(aht_tC, 1); Serial.print("C  ");

      // Влажность воздуха
      Serial.print("H=");
      Serial.print(aht_hR, 0); Serial.print("%  ");

      // Точка росы (расчётная по tC и hR)
      float dew = calcDewPoint(aht_tC, aht_hR);
      Serial.print("Dew="); Serial.print(dew, 1); Serial.print("C  ");
    } else {
      // Если AHT20 в ошибке – явно указываем, что нет данных по T/H
      Serial.print("AHT_ERR  ");
    }

    // --- Блок по давлению BMP280 ---
    if (bmp_ok) {
      // Текущее давление в мм рт. ст.
      Serial.print("P="); Serial.print(p_mmHg, 0); Serial.print("mmHg  pressureTrend=");

      // Печатаем состояние тренда давления:
      //   UP     -> давление растёт
      //   DOWN   -> давление падает
      //   STEADY -> практически не меняется
      //   N/A    -> тренд ещё не определён (T_STATE_TUNKNOWN)
      if (pressureTrend == T_STATE_RISE)        Serial.print("UP");
      else if (pressureTrend == T_STATE_FALL)   Serial.print("DOWN");
      else if (pressureTrend == T_STATE_STEADY) Serial.print("STEADY");
      else                                      Serial.print("N/A");
    } else {
      // Если BMP280 сейчас в ошибке – помечаем это
      Serial.print("BMP_ERR");
    }

    // --- Память ошибок по датчикам ---
    // Эти счётчики накапливаются за всё время работы и помогают
    // понять, сколько раз каждый датчик "сыпался".
    Serial.print("  memERR_AHT="); Serial.print(ahtErrCount);   // сколько раз AHT20 отваливался
    Serial.print("  memERR_BMP="); Serial.print(bmpErrCount);   // сколько раз BMP280 отваливался
    Serial.print("  memERR_MPU="); Serial.print(mpuErrCount);   // сколько раз были серьёзные ошибки MPU

    // Дополнительно – сколько ошибок MPU было при покое / в движении.
    // Эти значения накапливаются в блоке ошибок MPU ([F18.2.2]).
    Serial.print("  mpuErrStill="); Serial.print(mpuErrWhileStill);
    Serial.print("  mpuErrMove=");  Serial.print(mpuErrWhileMoving);
    Serial.println();
  }

  // --------------------------------------------------------------------------
  // [F18.7] ОБЩИЙ ЛОГ ВЫСОТЫ (раз в 1 секунду)
  // --------------------------------------------------------------------------
  // Этот блок каждую секунду (независимо от режима METEO/HUD) печатает в Serial
  // подробную информацию по барометрической высоте:
  //
  //   - altitude_m    : "сырая" относительная высота (после вычета altitudeOffset_m)
  //   - altitude_m_f  : сглаженная высота после фильтра
  //   - altZeroRef    : опорный "нулевой" уровень высоты (захватывается один раз
  //                     после периода стабилизации, см. pollEnvOnce())
  //   - alt_rel_now   : текущая относительная высота = altitude_m_f - altZeroRef
  //   - altState      : состояние "лестницы" высоты (ALT_IDLE / MOVING_UP / MOVING_DOWN)
  //   - altStep_m     : дискретная высота, которая отображается в HUD (окно Alt)
  //
  // Вывод в таком формате помогает видеть, как работает фильтрация и "лестница"
  // по высоте, и отлаживать пороги/фильтры при необходимости.
  static unsigned long lastAltDebugGlobal = 0;      // время последнего глобального лога высоты
  if (millis() - lastAltDebugGlobal > 1000) {       // если прошла как минимум 1 секунда
    lastAltDebugGlobal = millis();                  // обновляем отметку времени

    // Логируем высоту только если BMP280 в рабочем состоянии и
    // нулевой уровень высоты уже зафиксирован (altZeroRefSet == true).
    if (bmp_ok && altZeroRefSet) {
      // Текущая относительная высота (в метрах) относительно altZeroRef
      float alt_rel_now = altitude_m_f - altZeroRef;

      Serial.print("ALTLOG mode=");
      // Для наглядности указываем, в каком режиме сейчас находимся: METEO или HUD
      Serial.print(displayMode == 0 ? "METEO" : "HUD");

      Serial.print(" ms=");
      Serial.print(now);               // текущее время, мс с момента старта

      Serial.print(" raw=");
      Serial.print(altitude_m, 2);     // "сырая" высота (после вычета altitudeOffset_m)

      Serial.print(" f=");
      Serial.print(altitude_m_f, 2);   // сглаженная высота

      Serial.print(" zero=");
      Serial.print(altZeroRef, 2);     // опорный ноль высоты

      Serial.print(" rel=");
      Serial.print(alt_rel_now, 2);    // текущая относительная высота (f - zero)

      Serial.print(" state=");
      Serial.print((int)altState);     // состояние "лестницы" (0=IDLE, 1=UP, 2=DOWN)

      Serial.print(" step=");
      Serial.println(altStep_m, 2);    // дискретная "ступень" высоты для HUD
    }
  }

  // --------------------------------------------------------------------------
  // [F18.8] ОБНОВЛЕНИЕ ЭКРАНА (METEO / HUD)
  // --------------------------------------------------------------------------
  // Экран обновляем не "каждый цикл", а с заданной частотой:
  //
  //   - METEO (displayMode == 0):
  //       SCREEN_UPDATE_INTERVAL_METEO = 2000 мс
  //       -> обновление раз в 2 секунды.
  //
  //   - HUD (displayMode == 1):
  //       SCREEN_UPDATE_INTERVAL_HUD   = 200 мс
  //       -> примерно 5 кадров в секунду (достаточно для плавного горизонта).
  //
  // Логика:
  //   1) Выбираем интервал screenInt в зависимости от текущего режима.
  //   2) Если с момента последнего обновления (lastScreenUpdate) прошло
  //      больше, чем screenInt, то:
  //        - запоминаем текущее время в lastScreenUpdate;
  //        - перерисовываем нужный экран.
  //
  // Замечание:
  //   - переменная lastScreenUpdate иногда принудительно сбрасывается в 0
  //     (например, при переключении режима в [F18.5]), чтобы форсировать
  //     немедленное обновление экрана в этом же цикле.
  unsigned long screenInt = (displayMode == 0)
                            ? SCREEN_UPDATE_INTERVAL_METEO    // если METEO
                            : SCREEN_UPDATE_INTERVAL_HUD;     // если HUD

  // Проверяем, пришло ли время обновлять экран
  if (now - lastScreenUpdate > screenInt) {
    // Фиксируем момент последнего обновления
    lastScreenUpdate = now;

    if (displayMode == 0) {
      // --- METEO-режим ---
      // Каркас METEO (подписи, разметка) рисуется один раз в drawEnvFrame()
      // при входе в режим. Здесь каждый раз просто обновляем числовые значения:
      //   - температура, влажность, точка росы,
      //   - давление, тренд,
      //   - температура MPU,
      //   - статусы датчиков и их "память ошибок".
      updateEnvValues();

    } else {
      // --- HUD-режим ---
      if (mpu_ok) {
        // Если MPU в рабочем состоянии – рисуем HUD целиком:
        //   - линии горизонта, дуга крена, самолётик;
        //   - шкалы крена и тангажа;
        //   - окно высоты (altStep_m);
        //   - верхнюю шкалу виртуального курса;
        //   - численные значения крена/тангажа.
        drawHud();
      } else {
        // Если MPU в ошибке – вместо HUD показываем простое сообщение "MPU ERR"
        // на фиолетовом фоне, чтобы было видно, что ориентация недоступна.
        tft.fillScreen(COL_FON1);
        tft.setTextColor(ST77XX_RED, COL_FON1);
        tft.setTextSize(1);

        int16_t h = tft.height();
        tft.setCursor(10, h / 2 - 4);
        tft.print("MPU ERR");
      }
    }
  }
}