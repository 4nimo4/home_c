

/*
  Пример 3
  
В третьем примере мы воспользуемся библиотекой (она только для ATMEGI - GyverTimers). 
Пока это самый удобный способ управлять таймерами не трогая регистры.

Пишем по своему
*/
#include <Arduino.h>   // Базовая ардуино‑библиотека (пины, Serial, типы и т.п.)
#include <CBTimer.h>   // Библиотека CallbackTimerR4: обёртка над аппаратным таймером UNO R4
/*
Эта библиотека позволяет генерировать прерывания с заданным циклом и вызывать функции 
при срабатывании таймера. В отличие от оригинального таймера FSP, она может 
генерировать прерывания с очень длинными периодами — от нескольких секунд до целого часа.
Поэтому ее можно использовать для воспроизведения музыки с помощью функции tone() 
в сочетании с библиотекой BackgroundMusicR4.
*/

// ---------------------- НАСТРОЙКИ ВЫВОДОВ И ТАЙМЕРОВ -------------------------
#define SV1   3          // Пин, к которому подключён светодиод (через резистор на GND)
#define SV2   4          // Пин, к которому подключён светодиод (через резистор на GND)
#define SV3   5          // Пин, к которому подключён светодиод (через резистор на GND)
#define BTN   2          // Пин кнопки (кнопка -> GND, используем INPUT_PULLUP)

#define TIM0  1000        // порог до которого считает таймер 0 (~333 мс, 3 Гц)
#define TIM1  200       // порог до которого считает таймер 1 (1000 мс, 1 Гц)
#define TIM2  400       // порог до которого считает таймер 1 (1000 мс, 1 Гц)
#define TIM3  800       // порог до которого считает таймер 1 (1000 мс, 1 Гц)

// ---------------------- ОБЪЕКТ ТАЙМЕРА --------------------------------------
CBTimer myTimer;         // Объект таймера (использует один из таймеров RA4M1)

// ---------------------- ПЕРЕМЕННЫЕ ДЛЯ ВИРТУАЛЬНЫХ ТАЙМЕРОВ -----------------
volatile uint32_t tm0  = 0;   // счётчик для интервала ~333 мс (3 Гц)
volatile uint32_t tm1  = 0;   // счётчик для интервала 1000 мс (1 Гц)
volatile uint32_t tm2  = 0;   // счётчик для интервала ~333 мс (3 Гц)
volatile uint32_t tm3  = 0;   // счётчик для интервала 1000 мс (1 Гц)

// Флаги, которые выставляет обработчик прерывания таймера
volatile bool flagPrint = false;   // true -> в loop() нужно вывести "timer1"
volatile bool flagled1   = false;   // true -> в loop() нужно изменить состояние светодиода
volatile bool flagled2   = false;   // true -> в loop() нужно изменить состояние светодиода
volatile bool flagled3   = false;   // true -> в loop() нужно изменить состояние светодиода

// Флаг состояния нашего таймера: запущен / остановлен
volatile bool timerRunning = false; // по умолчанию таймер ВЫКЛЮЧЕН

// ---------------------- ОБРАБОТЧИК ТАЙМЕРА (КОЛБЭК) ------------------------
// Эта функция вызывается библиотекой CBTimer каждые 1 мс (см. myTimer.begin в setup()).
void timerCallback() {
  // Если таймер логически "остановлен" — ничего не делаем
  if (!timerRunning) 
    return;

  // Увеличиваем оба счётчика на 1 мс
  tm0++;
  tm1++;
  tm2++;
  tm3++;

  // --- "виртуальный" таймер №1: 3 Гц ---
  // Если прошло 333 тика по 1 мс ≈ 333 мс:
  if (tm0 >= TIM0) {
    tm0 = 0;             // сбрасываем счётчик
    flagPrint = true;    // ставим флаг: в loop() нужно вывести "timer1"
  }

  // --- "виртуальный" таймер №2: 1 Гц ---
  // Если прошло 1000 тиков по 1 мс = 1000 мс = 1 секунда:
  if (tm1 >= TIM1) {
    tm1 = 0;             // сбрасываем второй счётчик
    flagled1 = true;      // ставим флаг: в loop() нужно изменить состояние светодиода
  }

  if (tm2 >= TIM2) {
    tm2 = 0;             // сбрасываем второй счётчик
    flagled2 = true;      // ставим флаг: в loop() нужно изменить состояние светодиода
  }

  if (tm3 >= TIM3) {
    tm3 = 0;             // сбрасываем второй счётчик
    flagled3 = true;      // ставим флаг: в loop() нужно изменить состояние светодиода
  }
}

// ---------------------- ОБРАБОТЧИК КНОПКИ (ПРЕРЫВАНИЕ ПО D2) ----------------
// Реагируем только на НАЖАТИЕ (переход в LOW).
void buttonISR() {           // <-- без IRAM_ATTR
  static unsigned long lastInt = 0;
  unsigned long now = millis();

  // Софт‑антидребезг: игнорируем срабатывания чаще, чем раз в 50 мс
  if (now - lastInt < 50) 
    return;
  lastInt = now;

  // Проверяем, что это именно нажатие (кнопка -> GND, INPUT_PULLUP)
  if (digitalRead(BTN) == LOW) {
    // Переключаем состояние таймера
    timerRunning = !timerRunning;

    if (!timerRunning) {//если таймер остановлен
      // Таймер "остановлен" логически:
      // обнуляем счётчики и флаги, гасим светодиод
      tm0 = 0;
      tm1 = 0;
      tm2 = 0;
      tm3 = 0;
      flagPrint = false;
      flagled1   = false;
      flagled2   = false;
      flagled3   = false;
      digitalWrite(SV1, LOW);
      digitalWrite(SV2, LOW);
      digitalWrite(SV3, LOW);
    }
  }
}

// ---------------------- НАСТРОЙКА ПЛАТЫ -------------------------------------
void setup() {
  Serial.begin(115200);     // Настраиваем аппаратный UART, скорость 115200 бод.
                            // В мониторе порта нужно выбрать такую же скорость.

  pinMode(SV1, OUTPUT);     // Пин SV1 (3) — выход для светодиода
  pinMode(SV2, OUTPUT);
  pinMode(SV3, OUTPUT);
  digitalWrite(SV1, LOW);   // Стартуем с выключенного светодиода
  digitalWrite(SV2, LOW);
  digitalWrite(SV2, LOW);

  // Настраиваем кнопку: D2 -> кнопка -> GND, включаем внутреннюю подтяжку к +V
  pinMode(BTN, INPUT_PULLUP);

  // Подключаем внешнее прерывание к кнопке.
  // Используем режим CHANGE: ISR будет вызываться на любом изменении,
  // но внутри мы реагируем только когда пин стал LOW (нажатие).
  attachInterrupt(digitalPinToInterrupt(BTN), buttonISR, CHANGE);

  // Запускаем таймер CBTimer.
  // Параметры:
  //   1  -> период в миллисекундах (таймер вызывает callback каждые 1 мс),
  //   timerCallback -> указатель на нашу функцию-обработчик прерывания
  //   true          -> таймер RA4M1 физически запущен сразу,
  //                    но логически он "спит", пока timerRunning == false.
  myTimer.begin(1, timerCallback, true);
}

// ---------------------- ОСНОВНОЙ ЦИКЛ --------------------------------------
void loop() {
  // Таймер и кнопка работают независимо, в "фоне".

  if (flagPrint) {
    flagPrint = false;        // сбрасываем флаг, чтобы не печатать много раз подряд
    Serial.println("timer1"); // Выводим строку в порт.
  }

  if (flagled1) {
    flagled1 = false;          // сбрасываем флаг
    // Инвертируем состояние вывода SV1 — получается мигание раз в секунду.
    digitalWrite(SV1, !digitalRead(SV1));
  }

  if (flagled2) {
    flagled2 = false;          // сбрасываем флаг
    // Инвертируем состояние вывода SV1 — получается мигание раз в секунду.
    digitalWrite(SV2, !digitalRead(SV2));
  }

  if (flagled3) {
    flagled3 = false;          // сбрасываем флаг
    // Инвертируем состояние вывода SV1 — получается мигание раз в секунду.
    digitalWrite(SV3, !digitalRead(SV3));
  }
}