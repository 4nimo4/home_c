#include <math.h>

#define BUTT   12                   // кнопка    

#define LED_RED1_USER   2            // внешний красный светодиод
#define LED_GREEN1_USER 3           // внешний зелёный светодиод
#define LED_BLUE1_USER 4            // внешний синий светодиод
#define LED_YELLOW1_USER 5            // внешний желтый светодиод
#define LED_WHITE1_USER 6            // внешний белый светодиод
#define LED_WHITE2_USER 7            // внешний белый светодиод
#define LED_YELLOW2_USER 8            // внешний желтый светодиод
#define LED_BLUE2_USER 9            // внешний синий светодиод
#define LED_GREEN2_USER 10           // внешний зелёный светодиод
#define LED_RED2_USER   11            // внешний красный светодиод
#define ADR_LED_MAX        11         //индекс = количеству задействованных светодиодов на порту D
// у нас адесация со 2 по 11 
#define ADR_LED_MIN        2 
#define DELAY         50              //задержка для светодиодов
#define MOVE_TIMEOUT 5000            // время ожидания ввода равное 10 секундам
#define KOLOCH_REJIMOV 3            // количество установленных режимов - действует в связке с переменной int filtr = 1;


//---------------------------------------------------------------------------------------------
// Прототипы функций
//---------------------------------------------------------------------------------------------
void printButtonState();        //Прототип функции индикации индикации состояния кнопок
void Button_ON_OFF();          //Прототип функции опроса кнопки из ДЗ

//int avgBatchA0();               //Фильтр Среднее арифметическое
int movingAverageA0();          //Фильтр Скользящее среднее по окну WINDOW
float expoFilterA0(float);      // Экспоненциальный фильтр
void printAllFilters();         //Вывод на индикацию данных с потенциометра

//---------------------------------------------------------------------------------------------
// Глобальные переменныке и объекты
//---------------------------------------------------------------------------------------------
bool lastBtnState = HIGH;           // Предыдущее состояние кнопки (HIGH = не нажата при INPUT_PULLUP)
bool btnState = 0;                  //Состояние кнопки текущее
int lastPos = 0;                    // Предыдущее положение потенциометра (для отслеживания изменения)
unsigned long lastMoveTime = 0;      // время последнего начала отсчета до выхода из режима настройки

// Параметры фильтров
const int WINDOW = 30;        // длина окна скользящего среднего
//---------------------------------------------------------------------------------------------!!!!!!!!!!!
int filtr = 1;                //Фильтрация 1-выкл, 2-экспоненциальная 3-скользящее среднее 
//---------------------------------------------------------------------------------------------!!!!!!!!!!!!

// Экспоненциальный фильтр
float valExpo = -1.0;         // -1 = ещё не инициализировано
float koeff = 0.2;             //Скорость фильтрации, от 0.1 до 1.0 , чем ближе к 1 тем быстрее фильтрация 

// Скользящее среднее по окну
int  bufWin[WINDOW];          // буфер последних значений
long sumWin = 0;              // сумма элементов в буфере
int  idxWin = 0;              // текущий индекс в буфере
bool windowFilled = false;    // был ли буфер полностью заполнен 
//---------------------------------------------------------------------------------------------
// Настройка платы
//---------------------------------------------------------------------------------------------
void setup() {
  pinMode(BUTT, INPUT_PULLUP);      // Настраиваем пин кнопки как вход
 
  pinMode(LED_RED1_USER, OUTPUT);    
  pinMode(LED_GREEN1_USER, OUTPUT);  
  pinMode(LED_BLUE1_USER, OUTPUT);    
  pinMode(LED_YELLOW1_USER, OUTPUT);  
  pinMode(LED_WHITE1_USER, OUTPUT);    
  pinMode(LED_WHITE2_USER, OUTPUT);  
  pinMode(LED_YELLOW2_USER, OUTPUT);    
  pinMode(LED_BLUE2_USER, OUTPUT);  
  pinMode(LED_GREEN2_USER, OUTPUT);    
  pinMode(LED_RED2_USER, OUTPUT);  

  Serial.begin(9600);               // Запускаем последовательный порт на скорости 9600 бод
  for (int i = 0; i < WINDOW; i++) {  //очищаем буфер
    bufWin[i] = 0;
  }
}

//---------------------------------------------------------------------------------------------
// Главный цикл
//---------------------------------------------------------------------------------------------
void loop() {
  btnState = digitalRead(BUTT);   // Считываем текущее состояние кнопки (HIGH или LOW)
  //---------------------------------------------------------------------------------------------
  // 3. Обработка изменения состояния кнопки по ДЗ и измеряем напряжение на pin A0
  //---------------------------------------------------------------------------------------------
  if (btnState != lastBtnState) {         // Если состояние кнопки изменилось по сравнению с прошлым
    Button_ON_OFF();
  }
  printAllFilters();  
  //---------------------------------------------------------------------------------------------
  delay(50);                               // Пауза 30 мс перед новым циклом
}
//---------------------------------------------------------------------------------------------

//---------------------------------------------------------------------------------------------
// Функция вывода на индикацию нажатия кнопок
//---------------------------------------------------------------------------------------------
void printButtonState() {
  if (btnState != lastBtnState){  
    if (btnState == LOW) {                // Если теперь LOW – кнопку нажали
      Serial.println("Button: PRESSED");  // Пишем в монитор порта, что кнопка нажата
    } else {                              // Иначе стало HIGH – кнопку отпустили
      Serial.println("Button: released"); // Пишем в монитор порта, что кнопка отпущена
    }
  }
}

//---------------------------------------------------------------------------------------------
// Функция обработки нажатия кнопки из ДЗ
//---------------------------------------------------------------------------------------------
void Button_ON_OFF() 
{
  if (btnState == LOW) 
  {                // Если теперь LOW – кнопку нажали
    // ВХОД В РЕЖИМ НАСТРОЙКИ: бегущая дорожка 2..11
    for (int i = ADR_LED_MIN; i <= ADR_LED_MAX; i++)
    {  
      digitalWrite(i, HIGH);
      delay(DELAY);
      digitalWrite(i, LOW);
      delay(DELAY); 
    }

    lastBtnState = btnState;  // запоминаем, что кнопка сейчас нажата

    Serial.println("Настройте режим фильтрации с помощью кнопки, количество включенных светодиодов индицирует установленный режим:");
    Serial.print("Сейчас установлен режим = ");
    Serial.println(filtr);

    // Индикация текущего режима: зажигаем N светодиодов справа
    for (int i = ADR_LED_MAX, y = ADR_LED_MAX - filtr; i > y; i--)
    {  
      digitalWrite(i, HIGH);
      delay(DELAY * 2);
    }

    Serial.println("Доступные режимы для ввода:");
    Serial.println("1 - Фильтрация отключена - выводим сырые значения");
    Serial.println("2 - Фильтрация экспоненциальное сглаживание");
    Serial.println("3 - Фильтрация Скользящее среднее по окну WINDOW");
    Serial.println("Короткими нажатиями кнопки выберите режим (1..3), по истечении времени текущий режим будет сохранён.");

    // ------------------ ВАЖНО: направление изменения ------------------
    int dir = +1;                  // направление изменения фильтра (+1 или -1)
    if (filtr == KOLOCH_REJIMOV)   // если изначально стоял максимальный режим,
      dir = -1;                    // сначала пойдём вниз
    //------------------------------------------------------------------

    lastMoveTime = millis();       // запоминаем время начала настройки

    // РЕЖИМ НАСТРОЙКИ:  крутимся пока не истечёт MOVE_TIMEOUT
    while (millis() - lastMoveTime < MOVE_TIMEOUT) 
    {
      // внутри цикла ОБЯЗАТЕЛЬНО обновляем состояние кнопки
      btnState = digitalRead(BUTT);

      // Реагируем только на ПЕРЕХОД: HIGH -> LOW (нажатие)
      if (btnState == LOW && lastBtnState == HIGH)
      {
        // Погасим текущую индикацию режима
        for (int i = ADR_LED_MAX, y = ADR_LED_MAX - filtr; i > y; i--)
        {  
          digitalWrite(i, LOW);
          delay(DELAY);
        }

        // Меняем значение фильтра по текущему направлению
        filtr += dir;

        // Если ушли за границы, меняем направление
        if (filtr >= KOLOCH_REJIMOV) 
        {
          filtr = KOLOCH_REJIMOV;
          dir   = -1;          // дальше двигаемся вниз
        }
        else if (filtr <= 1)
        {
          filtr = 1;
          dir   = +1;          // дальше двигаемся вверх
        }

        // Зажигаем светодиоды под новый режим
        for (int i = ADR_LED_MAX, y = ADR_LED_MAX - filtr; i > y; i--)
        {  
          digitalWrite(i, HIGH);
          delay(DELAY);
        }

        // Обновляем "предыдущее" состояние кнопки
        lastBtnState = btnState;

        // (опционально) можно обновить lastMoveTime, если ннужно
        // чтобы таймер 5 секунд отсчитывался "с последнего изменения"
        // lastMoveTime = millis();
      }
      else if (btnState == HIGH && lastBtnState == LOW)
      {
        // Кнопка отпущена – фиксируем
        lastBtnState = btnState;
      }
      // -------------------------------------------------
    }

    Serial.print("Выходим из режима настройки, выбран режим = ");
    Serial.println(filtr);

    // АНИМАЦИЯ ВЫХОДА: бегущая дорожка 11..2
    for (int i = ADR_LED_MAX; i >= ADR_LED_MIN; i--)
    {  
      digitalWrite(i, HIGH);
      delay(DELAY);
      digitalWrite(i, LOW);
      delay(DELAY); 
    } 
  }

  // Вне зависимости от того, вошёл/не вошёл в режим – обновляем lastBtnState
  lastBtnState = btnState;
}
//---------------------------------------------------------------------------------------------
// Функции измерения напряжения на ножке A0
//---------------------------------------------------------------------------------------------
//---------------------------------------------------------------------------------------------
//                Простая фильтрация
//---------------------------------------------------------------------------------------------
/*По разным причинам (например, некачественный источник питания, наводки и т. д.) мы можем
наблюдать шум. То есть, когда мы считываем положение потенциометра, показания колеблются в
каких то пределах. Этого можно избежать, фильтруя входной сигнал, и для этого есть несколько
способов*/
//---------------------------------------------------------------------------------------------
// Среднее арифметическое
//---------------------------------------------------------------------------------------------
/*Среднее арифметическое по N измерениям:
  если бы 10 раз подряд прочитал потенциометр и сказал: «в среднем сейчас примерно вот столько».
  Каждое новое среднее почти независимое от предыдущего .*/
//int avgBatchA0() {
//  long sum = 0;
 // for (int i = 0; i < NUMS; i++) {
//    int raw = analogRead(A0);                 // 0..1023
  /*А что делать, если нас не устраивает значения от 0 до 1023? Скажем, нам нужны значения от
  0 до 10. Для масштабирования значений есть специальная функция map(). В ней необходимо указать
  5 аргументов - входная величина(наша переменная), ее минимальное значение, ее максимальное
  значение, затем минимально и максимально значение, которое мы хотим получить на выходе.
  но на самом деле это не классическое масштабирование- это перенос гранц (были одни, стали другие)
  */
 //   int val = map(raw, 0, 1023, 0, 10);    // 0..10
    /*Если мы выйдем из входного диапазона, то и выходные значения из него выйдут. Поэтому
    воспользуемся функцией constrain() чтобы ограничить выходные значения.*/
  //  val = constrain(val, 0, 10);
  //  sum += val;
  //}
 // return (int)(sum / NUMS);
//}

//---------------------------------------------------------------------------------------------
// Экспоненциальный фильтр
//---------------------------------------------------------------------------------------------
/*каждый новый отсчёт чуть-чуть подмешивается к предыдущему результату.
Гладкая кривая, меньше шума, но с небольшим запаздыванием.*/

// Экспоненциальное сглаживание, результат 0..10
float expoFilterA0(float alpha) {
  int raw = analogRead(A0);                 // 0..1023
  int val = map(raw, 0, 910, 0, 10);       // 0..10
  val = constrain(val, 0, 10);

  if (valExpo < 0) {        // первый вызов
    valExpo = val;
  } else {
    valExpo = valExpo + (val - valExpo) * alpha;
  }
  return valExpo;
}

//---------------------------------------------------------------------------------------------
// Скользящее среднее по окну WINDOW
//---------------------------------------------------------------------------------------------
// Скользящее среднее по окну WINDOW, результат 0..10
int movingAverageA0() {
  int raw = analogRead(A0);                 // 0..1023
  int val = map(raw, 0, 910, 0, 10);       // 0..10
  val = constrain(val, 0, 10);

  // вычитаем старое значение из суммы
  sumWin -= bufWin[idxWin];
  // записываем новое
  bufWin[idxWin] = val;
  // добавляем к сумме
  sumWin += val;

  idxWin++;
  if (idxWin >= WINDOW) {
    idxWin = 0;
    windowFilled = true;
  }

  int n = windowFilled ? WINDOW : idxWin;   // сколько реально значений в буфере
  if (n == 0) return val;                  // защита на первом шаге

  return (int)(sumWin / n);
}
//---------------------------------------------------------------------------------------------
// Вывод на индикацию
//---------------------------------------------------------------------------------------------
 void printAllFilters() 
 {
    //---------------------------------------------------------------------------------------------
    if(filtr == 1)
    { //Фильтрация отключена - выводим сырые значения
      int raw = analogRead(A0);                 // 0..1023
      int pos = map(raw, 0, 910, 0, 10);       // 0..10
      pos = constrain(pos, 0, 10);

      if (pos != lastPos) 
      {
        Serial.print("  без фильтрации =");
        Serial.println(pos);
        if (pos > lastPos) 
        {
          for(int i=ADR_LED_MIN+lastPos, y=i+pos-lastPos; i<y; i++)
            {   
              digitalWrite(i, HIGH);
              delay(DELAY);
            }
        }
        else
        {
          for(int i=ADR_LED_MIN+lastPos-1, y=i-(lastPos-pos); i>y; i--)
          {  
            digitalWrite(i, LOW);
            delay(DELAY);
          }
        }
        lastPos = pos;                    // обновляем
      }
    }

    //---------------------------------------------------------------------------------------------
    else if(filtr == 2)
    { //Фильтрация экспоненциальное сглаживание
      float expo = expoFilterA0(koeff);
      int pos = (int)round(expo);
      if (pos != lastPos) 
      {
        Serial.print("  экспоненциальное сглаживание =");
        Serial.println(pos);
        if (pos > lastPos) 
        {
          for(int i=ADR_LED_MIN+lastPos, y=i+pos-lastPos; i<y; i++)
            {   
              digitalWrite(i, HIGH);
              delay(DELAY);
            }
        }
        else
        {
          for(int i=ADR_LED_MIN+lastPos-1, y=i-(lastPos-pos); i>y; i--)
          {  
            digitalWrite(i, LOW);
            delay(DELAY);
          }
        }
        lastPos = pos;                    // обновляем
      }
    }

    //---------------------------------------------------------------------------------------------
    else if(filtr == 3)
    { //Фильтрация Скользящее среднее по окну WINDOW
      int maWindow = movingAverageA0();
      int pos = maWindow;
      if (pos != lastPos) 
      {
        Serial.print("  скользящее среднее по окну WINDOW =");

        Serial.println(pos);
        if (pos > lastPos) 
        {
          for(int i=ADR_LED_MIN+lastPos, y=i+pos-lastPos; i<y; i++)
            {   
              digitalWrite(i, HIGH);
              delay(DELAY);
            }
        }
        else
        {
          for(int i=ADR_LED_MIN+lastPos-1, y=i-(lastPos-pos); i>y; i--)
          {  
            digitalWrite(i, LOW);
            delay(DELAY);
          }
        }
        lastPos = pos;                    // обновляем
      }
    }    
  }
  //---------------------------------------------------------------------------------------------

  
  
 

