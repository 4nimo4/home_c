#include <RotaryEncoder.h>          // Подключаем библиотеку для работы с энкодером

// Пины энкодера (DT, CLK) 
#define DT   2                  // подключен к выходу DT энкодера
#define CLK  3                  // подключен к выходу CLK энкодера
#define BUT  4                  // подключен к кнопке энкодера
#define BUT2  7                  // подключен к кнопке энкодера
#define LED_RED_USER   5            // внешний красный светодиод
#define LED_GREEN_USER 6            // внешний зелёный светодиод
#define MOVE_TIMEOUT 200            // время опроса энкодера в мс

//---------------------------------------------------------------------------------------------
// Прототипы функций
//---------------------------------------------------------------------------------------------
void printButtonState();        //Прототип функции индикации индикации состояния кнопок
void Button2_ON_OFF();          //Прототип функции опроса кнопки из ДЗ
void Button_Encoder_ON_OFF();   //Прототип функции опроса кнопки Энкодера
void Encoder_ON();              //Прототип функции работы Энкодера

//---------------------------------------------------------------------------------------------
// Глобальные переменныке и объекты
//---------------------------------------------------------------------------------------------
RotaryEncoder encoder(DT, CLK); // Создаем объект энкодера и передаём пины DT и CLK

long pos     = 0;                    // Текущее положение энкодера (начинаем с 0)
long lastPos = 0;                    // Предыдущее положение энкодера (для отслеживания изменения)
bool lastBtnState = HIGH;            // Предыдущее состояние кнопки (HIGH = не нажата при INPUT_PULLUP)
bool lastBtnState2 = HIGH;           // Предыдущее состояние кнопки (HIGH = не нажата при INPUT_PULLUP)
bool btnState = 0;                   //Состояние кнопки на энкодере
bool btnState2 = 0;                  //Состояние кнопки из ДЗ
long accumulatedDelta = 0;           // накопленное изменение позиции
unsigned long lastMoveTime = 0;      // время последнего движения


//---------------------------------------------------------------------------------------------
// Настройка платы
//---------------------------------------------------------------------------------------------
void setup() {
  pinMode(BUT, INPUT_PULLUP);         // Настраиваем пин кнопки как вход с внутренней подтяжкой к VCC
  pinMode(BUT2, INPUT_PULLUP);      // Настраиваем пин кнопки как вход
  //pinMode(BUT2, INPUT);        // вариант без подтяжки
  pinMode(LED_RED_USER, OUTPUT);    // Настраиваем пин красного светодиода как выход
  pinMode(LED_GREEN_USER, OUTPUT);  // Настраиваем пин зелёного светодиода как выход

  Serial.begin(9600);               // Запускаем последовательный порт на скорости 9600 бод
  Serial.println(pos);              // Выводим начальное значение позиции энкодера (0)
}

//---------------------------------------------------------------------------------------------
// Главный цикл
//---------------------------------------------------------------------------------------------
void loop() {
  // Обновляем состояние энкодера (читаем его выводы DT/CLK внутри библиотеки)
  btnState = digitalRead(BUT);   // Считываем текущее состояние кнопки (HIGH или LOW)
  btnState2 = digitalRead(BUT2);   // Считываем текущее состояние кнопки (HIGH или LOW)
  encoder.tick();                   // Сообщаем библиотеке, что надо опросить энкодер
  pos = encoder.getPosition();      // Получаем текущее положение энкодера (счётчик шагов)

  //---------------------------------------------------------------------------------------------
  // 1. Обработка вращения
  //---------------------------------------------------------------------------------------------
  if (pos != lastPos) {             // Если положение изменилось (ручку повернули)
    long delta = pos - lastPos;       // изменение за этот шаг
    accumulatedDelta += delta;        // накапливаем общее изменение
    lastMoveTime = millis();          // запоминаем момент последнего движения

    lastPos = pos;                    // обновляем
  }

  // 1.1. Проверяем, не закончено ли вращение
  if (accumulatedDelta != 0 && (millis() - lastMoveTime > MOVE_TIMEOUT)) {
    // СЮДА мы попадаем один раз после того, как энкодер «успокоился» на MOVE_TIMEOUT мс
    Encoder_ON();
  }
  //---------------------------------------------------------------------------------------------
  // 2. Обработка изменения состояния кнопки энкодера (отдельно от вращения)
  //---------------------------------------------------------------------------------------------
  if (btnState != lastBtnState) {         // Если состояние кнопки изменилось по сравнению с прошлым
    Button_Encoder_ON_OFF();
  }
  //---------------------------------------------------------------------------------------------
  // 3. Обработка изменения состояния кнопки по ДЗ
  //---------------------------------------------------------------------------------------------
  if (btnState2 != lastBtnState2) {         // Если состояние кнопки изменилось по сравнению с прошлым
    Button2_ON_OFF();
  }

  delay(1);                               // Пауза 1 мс перед новым циклом
}
//---------------------------------------------------------------------------------------------

//---------------------------------------------------------------------------------------------
// Функция вывода на индикацию нажатия кнопок
//---------------------------------------------------------------------------------------------
void printButtonState() {
  if (btnState != lastBtnState){  
    if (btnState == LOW) {                // Если теперь LOW – кнопку нажали
      Serial.println("Button Encoder: PRESSED");  // Пишем в монитор порта, что кнопка нажата
    } else {                              // Иначе стало HIGH – кнопку отпустили
      Serial.println("Button Encoder: released"); // Пишем в монитор порта, что кнопка отпущена
    }
  }
  if (btnState2 != lastBtnState2){  
    if (btnState2 == LOW) {                // Если теперь LOW – кнопку нажали
      Serial.println("Button2: PRESSED");  // Пишем в монитор порта, что кнопка нажата
    } else {                              // Иначе стало HIGH – кнопку отпустили
      Serial.println("Button2: released"); // Пишем в монитор порта, что кнопка отпущена
    }
  }
}

//---------------------------------------------------------------------------------------------
// Функция обработки нажатия кнопки из ДЗ
//---------------------------------------------------------------------------------------------
void Button2_ON_OFF() {
    if (btnState2 == LOW) {                // Если теперь LOW – кнопку нажали  
      digitalWrite(LED_GREEN_USER, HIGH); 
    } else {                              // Иначе стало HIGH – кнопку отпустили   
      digitalWrite(LED_GREEN_USER, LOW);  
    }
    printButtonState();
    lastBtnState2 = btnState2;              // Обновляем сохранённое состояние кнопки
}

//---------------------------------------------------------------------------------------------
// Функция обработки нажатия кнопки Энкодлера
//---------------------------------------------------------------------------------------------
void Button_Encoder_ON_OFF() {
    if (btnState == LOW) {                // Если теперь LOW – кнопку нажали  
      digitalWrite(LED_RED_USER, HIGH); 
    } else {                              // Иначе стало HIGH – кнопку отпустили   
      digitalWrite(LED_RED_USER, LOW);  
    }
    printButtonState();
    lastBtnState = btnState;              // Обновляем сохранённое состояние кнопки
}

//---------------------------------------------------------------------------------------------
// Функция обработки врщения ручки Энкодлера
//---------------------------------------------------------------------------------------------
void Encoder_ON() {             // Если положение изменилось (ручку повернули)
     // Пример индикации: если суммарное смещение > 0 — красный, < 0 — зелёный
    if (accumulatedDelta > 0) {
      Serial.print("LED_GREEN DELTA LEFTH= ");  
      digitalWrite(LED_RED_USER, LOW);
      digitalWrite(LED_GREEN_USER, HIGH);
    } else if (accumulatedDelta < 0) {
      Serial.print("LED_RED DELTA RIGHT= ");
      digitalWrite(LED_RED_USER, HIGH);
      digitalWrite(LED_GREEN_USER, LOW);
    }
    Serial.println(accumulatedDelta);   // выводим суммарное изменение

    delay(300);                         // подержать индикацию
    digitalWrite(LED_RED_USER, LOW);
    digitalWrite(LED_GREEN_USER, LOW);

    accumulatedDelta = 0;               // сбрасываем накопитель
}